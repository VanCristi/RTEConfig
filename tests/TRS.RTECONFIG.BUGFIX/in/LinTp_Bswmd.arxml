AUTOSAR XML (schema 4-0-3)
package /AUTOSAR_LinTp/BswModuleDescriptions
  bsw module description LinTp: module-id=62, provided-entrys=LinTp_Init
    bsw internal behavior InternalBehavior_0
      bsw called entity LinTp_Init: implemented-entry=LinTp_Init
package /AUTOSAR_LinTp/BswModuleEntrys
  bsw module entry LinTp_Init: service-id=28, is-reentrant=false, is-synchronous=true, call-type=REGULAR, execution-context=TASK, sw-service-impl-policy=STANDARD
    sw service arg ConfigPtr: direction=IN, implementation-data-type=VoidPtr
package /EB_LinIf_TxDxM5I6R0/Implementations
  bsw implementation BswImplementation_LinTp: programming-language=C, sw-version=5.6.0, vendor-id=1, ar-release-version=4.0.3, behavior=InternalBehavior_0, vendor-specific-module-def=LinIf
    code-descriptors:
      code Files: artifact-descriptors=autosar-engineering-object={short-label=Autosar::include::LinTp.h, category=SWHDR}
    resource consumption ResourceConsumption
      memory section CONFIG_DATA_UNSPECIFIED: alignment=UNSPECIFIED, sw-addrmethod=CONFIG_DATA
