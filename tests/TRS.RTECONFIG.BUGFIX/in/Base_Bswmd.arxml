AUTOSAR XML (schema 4-0-3)
standard types defined: Std_ReturnType, void, sint8, sint16, sint32, uint8, uint16, uint32, sint8_least, sint16_least, sint32_least, uint8_least, uint16_least, uint32_least, float32, float64, sint64, uint64, boolean
package /AUTOSAR_Std/ImplementationDataTypes
  impl type Std_VersionInfoType: category=STRUCTURE, type-emitter=BSW
    5 x element, all with category=TYPE_REFERENCE:
      vendorID: implementation-data-type=ImplementationDataTypes/uint16
      moduleID: implementation-data-type=ImplementationDataTypes/uint16
      sw_major_version: implementation-data-type=ImplementationDataTypes/uint8
      sw_minor_version: implementation-data-type=ImplementationDataTypes/uint8
      sw_patch_version: implementation-data-type=ImplementationDataTypes/uint8
package /AUTOSAR_Platform/ImplementationDataTypes
  impl type ConstVoidPtr: category=DATA_REFERENCE, sw-pointer-target-props={target-category=VALUE, base-type=BaseTypes/void, sw-impl-policy=CONST}, type-emitter=BSW
  impl type VoidPtr: category=DATA_REFERENCE, sw-pointer-target-props={target-category=VALUE, base-type=BaseTypes/void}, type-emitter=BSW
package /AUTOSAR_Platform/CompuMethods
  compu method boolean_Literals: 0=FALSE, 1=TRUE
package /AUTOSAR_Comtype/ImplementationDataTypes
  10 x impl type, all with type-emitter=BSW:
    PduIdType: implementation-data-type=ImplementationDataTypes/uint16
    PduLengthType: implementation-data-type=ImplementationDataTypes/uint16
    PduInfoType: category=STRUCTURE
      element SduDataPtr: category=DATA_REFERENCE, sw-pointer-target-props={target-category=TYPE_REFERENCE, implementation-data-type=ImplementationDataTypes/uint8}
      element SduLength: implementation-data-type=ImplementationDataTypes/PduLengthType
    TPParameterType: compu {0=TP_STMIN, 1=TP_BS, 2=TP_BC}, implementation-data-type=ImplementationDataTypes/uint32
    BufReq_ReturnType: compu {0=BUFREQ_OK, 1=BUFREQ_E_NOT_OK, 2=BUFREQ_E_BUSY, 3=BUFREQ_E_OVFL}, implementation-data-type=ImplementationDataTypes/uint32
    NotifResultType: implementation-data-type=ImplementationDataTypes/uint8
    BusTrcvErrorType: implementation-data-type=ImplementationDataTypes/uint8
    TpDataStateType: compu {0=TP_DATACONF, 1=TP_DATARETRY, 2=TP_CONFPENDING}, implementation-data-type=ImplementationDataTypes/uint32
    RetryInfoType: category=STRUCTURE
      element TpDataState: implementation-data-type=ImplementationDataTypes/TpDataStateType
      element TxTpDataCnt: implementation-data-type=ImplementationDataTypes/PduLengthType
    NetworkHandleType: implementation-data-type=ImplementationDataTypes/uint8
package /AUTOSAR_Can/ImplementationDataTypes
  5 x impl type, all with type-emitter=BSW:
    Can_IdType: implementation-data-type=ImplementationDataTypes/uint32
    Can_HwHandleType: implementation-data-type=ImplementationDataTypes/uint8
    Can_PduType: category=STRUCTURE
      4 x element:
        id: implementation-data-type=ImplementationDataTypes/Can_IdType
        length: implementation-data-type=ImplementationDataTypes/uint8
        sdu: category=DATA_REFERENCE, sw-pointer-target-props={target-category=TYPE_REFERENCE, implementation-data-type=ImplementationDataTypes/uint8}
        swPduHandle: implementation-data-type=ImplementationDataTypes/PduIdType
    Can_StateTransitionType: compu {0=CAN_T_START, 1=CAN_T_STOP, 2=CAN_T_SLEEP, 3=CAN_T_WAKEUP}, implementation-data-type=ImplementationDataTypes/uint32
    Can_ReturnType: compu {0=CAN_OK, 1=CAN_NOT_OK, 2=CAN_BUSY}, implementation-data-type=ImplementationDataTypes/uint32
package /AUTOSAR_CanTrcv/ImplementationDataTypes
  5 x impl type, all with category=TYPE_REFERENCE, implementation-data-type=ImplementationDataTypes/uint32, type-emitter=BSW:
    CanTrcv_TrcvModeType: compu-method=CanTrcv_TrcvModeType_Literals
    CanTrcv_TrcvWakeupReasonType: compu-method=CanTrcv_TrcvWakeupReasonType_Literals
    CanTrcv_TrcvWakeupModeType: compu-method=CanTrcv_TrcvWakeupModeType_Literals
    CanTrcv_PNActivationType: compu {0=PN_ENABLED, 1=PN_DISABLED}
    CanTrcv_TrcvFlagStateType: compu {0=CANTRCV_FLAG_SET, 1=CANTRCV_FLAG_CLEARED}
package /AUTOSAR_CanTrcv/CompuMethods
  compu method CanTrcv_TrcvModeType_Literals: 0=CANTRCV_TRCVMODE_NORMAL, 1=CANTRCV_TRCVMODE_SLEEP, 2=CANTRCV_TRCVMODE_STANDBY
  compu method CanTrcv_TrcvWakeupReasonType_Literals: 0=CANTRCV_WU_BY_BUS, 1=CANTRCV_WU_BY_PIN, 2=CANTRCV_WU_ERROR, 3=CANTRCV_WU_INTERNALLY, 4=CANTRCV_WU_NOT_SUPPORTED, 5=CANTRCV_WU_POWER_ON, 6=CANTRCV_WU_RESET
  compu method CanTrcv_TrcvWakeupModeType_Literals: 0=CANTRCV_WUMODE_CLEAR, 1=CANTRCV_WUMODE_DISABLE, 2=CANTRCV_WUMODE_ENABLE
package /AUTOSAR_Lin/ImplementationDataTypes
  6 x impl type, all with type-emitter=BSW:
    Lin_FramePidType: implementation-data-type=ImplementationDataTypes/uint8
    Lin_FrameCsModelType: compu {0=LIN_ENHANCED_CS, 1=LIN_CLASSIC_CS}, implementation-data-type=ImplementationDataTypes/uint32
    Lin_FrameResponseType: compu {0=LIN_MASTER_RESPONSE, 1=LIN_SLAVE_RESPONSE, 2=LIN_SLAVE_TO_SLAVE}, implementation-data-type=ImplementationDataTypes/uint32
    Lin_FrameDlType: implementation-data-type=ImplementationDataTypes/uint8
    Lin_PduType: category=STRUCTURE
      5 x element:
        Pid: implementation-data-type=ImplementationDataTypes/Lin_FramePidType
        Cs: implementation-data-type=ImplementationDataTypes/Lin_FrameCsModelType
        Drc: implementation-data-type=ImplementationDataTypes/Lin_FrameResponseType
        Dl: implementation-data-type=ImplementationDataTypes/Lin_FrameDlType
        SduPtr: category=DATA_REFERENCE, sw-pointer-target-props={target-category=TYPE_REFERENCE, implementation-data-type=ImplementationDataTypes/uint8}
    Lin_StatusType: compu-method=Lin_StatusType_Literals, implementation-data-type=ImplementationDataTypes/uint32
package /AUTOSAR_Lin/CompuMethods
  compu method Lin_StatusType_Literals: 0=LIN_NOT_OK, 1=LIN_TX_OK, 2=LIN_TX_BUSY, 3=LIN_TX_HEADER_ERROR, 4=LIN_TX_ERROR, 5=LIN_RX_OK, 6=LIN_RX_BUSY, 7=LIN_RX_ERROR, 8=LIN_RX_NO_RESPONSE, 9=LIN_OPERATIONAL, 10=LIN_CH_SLEEP
package /AUTOSAR_LinTrcv/ImplementationDataTypes
  impl type LinTrcv_TrcvModeType: compu-method=LinTrcv_TrcvModeType_Literals, implementation-data-type=ImplementationDataTypes/uint32, type-emitter=BSW
  impl type LinTrcv_TrcvWakeupModeType: compu-method=LinTrcv_TrcvWakeupModeType_Literals, implementation-data-type=ImplementationDataTypes/uint32, type-emitter=BSW
  impl type LinTrcv_TrcvWakeupReasonType: compu-method=LinTrcv_TrcvWakeupReasonType_Literals, implementation-data-type=ImplementationDataTypes/uint32, type-emitter=BSW
package /AUTOSAR_LinTrcv/CompuMethods
  compu method LinTrcv_TrcvModeType_Literals: 0=LINTRCV_TRCV_MODE_NORMAL, 1=LINTRCV_TRCV_MODE_SLEEP, 2=LINTRCV_TRCV_MODE_STANDBY
  compu method LinTrcv_TrcvWakeupModeType_Literals: 0=LINTRCV_WUMODE_ENABLE, 1=LINTRCV_WUMODE_DISABLE, 2=LINTRCV_WUMODE_CLEAR
  compu method LinTrcv_TrcvWakeupReasonType_Literals: 0=LINTRCV_WU_ERROR, 1=LINTRCV_WU_NOT_SUPPORTED, 2=LINTRCV_WU_BY_BUS, 3=LINTRCV_WU_BY_PIN, 4=LINTRCV_WU_INTERNALLY, 5=LINTRCV_WU_RESET, 6=LINTRCV_WU_POWER_ON
package /AUTOSAR_MemMap/SwAddrMethods
  12 x sw addr method:
    CODE: memory-allocation-keyword-policy=ADDR-METHOD-SHORT-NAME, section-type=CODE
    CALLOUT_CODE: memory-allocation-keyword-policy=ADDR-METHOD-SHORT-NAME, section-type=CODE
    VAR: memory-allocation-keyword-policy=ADDR-METHOD-SHORT-NAME-AND-ALIGNMENT, section-initialization-policy=INIT, section-type=VAR
    VAR_INIT: memory-allocation-keyword-policy=ADDR-METHOD-SHORT-NAME-AND-ALIGNMENT, section-initialization-policy=INIT, section-type=VAR
    VAR_NOINIT: memory-allocation-keyword-policy=ADDR-METHOD-SHORT-NAME-AND-ALIGNMENT, section-initialization-policy=NO-INIT, section-type=VAR
    VAR_CLEARED: memory-allocation-keyword-policy=ADDR-METHOD-SHORT-NAME-AND-ALIGNMENT, section-initialization-policy=CLEARED, section-type=VAR
    VAR_POWER_ON_INIT: memory-allocation-keyword-policy=ADDR-METHOD-SHORT-NAME-AND-ALIGNMENT, section-initialization-policy=POWER-ON-INIT, section-type=VAR
    VAR_POWER_ON_CLEARED: memory-allocation-keyword-policy=ADDR-METHOD-SHORT-NAME-AND-ALIGNMENT, section-initialization-policy=POWER-ON-CLEARED, section-type=VAR
    VAR_FAST: memory-allocation-keyword-policy=ADDR-METHOD-SHORT-NAME-AND-ALIGNMENT, section-initialization-policy=INIT, section-type=VAR-FAST
    CONST: memory-allocation-keyword-policy=ADDR-METHOD-SHORT-NAME-AND-ALIGNMENT, section-type=CONST
    CALIB: memory-allocation-keyword-policy=ADDR-METHOD-SHORT-NAME-AND-ALIGNMENT, section-initialization-policy=INIT, section-type=CALPRM
    CONFIG_DATA: memory-allocation-keyword-policy=ADDR-METHOD-SHORT-NAME-AND-ALIGNMENT, section-type=CONFIG-DATA
package /AUTOSAR/Std/ImplementationDataTypes
  impl type Std_VersionInfoType: category=STRUCTURE, type-emitter=BSW
    5 x element, all with category=TYPE_REFERENCE:
      vendorID: implementation-data-type=ImplementationDataTypes/uint16
      moduleID: implementation-data-type=ImplementationDataTypes/uint16
      sw_major_version: implementation-data-type=ImplementationDataTypes/uint8
      sw_minor_version: implementation-data-type=ImplementationDataTypes/uint8
      sw_patch_version: implementation-data-type=ImplementationDataTypes/uint8
package /AUTOSAR/Platform/ImplementationDataTypes
  impl type ConstVoidPtr: category=DATA_REFERENCE, sw-pointer-target-props={target-category=VALUE, base-type=BaseTypes/void, sw-impl-policy=CONST}, type-emitter=BSW
  impl type VoidPtr: category=DATA_REFERENCE, sw-pointer-target-props={target-category=VALUE, base-type=BaseTypes/void}, type-emitter=BSW
package /AUTOSAR/Comtype/ImplementationDataTypes
  10 x impl type, all with type-emitter=BSW:
    PduIdType: implementation-data-type=ImplementationDataTypes/uint16
    PduLengthType: implementation-data-type=ImplementationDataTypes/uint16
    PduInfoType: category=STRUCTURE
      element SduDataPtr: category=DATA_REFERENCE, sw-pointer-target-props={target-category=TYPE_REFERENCE, implementation-data-type=ImplementationDataTypes/uint8}
      element SduLength: implementation-data-type=ImplementationDataTypes/PduLengthType
    TPParameterType: compu {0=TP_STMIN, 1=TP_BS, 2=TP_BC}, implementation-data-type=ImplementationDataTypes/uint32
    BufReq_ReturnType: compu {0=BUFREQ_OK, 1=BUFREQ_E_NOT_OK, 2=BUFREQ_E_BUSY, 3=BUFREQ_E_OVFL}, implementation-data-type=ImplementationDataTypes/uint32
    NotifResultType: implementation-data-type=ImplementationDataTypes/uint8
    BusTrcvErrorType: implementation-data-type=ImplementationDataTypes/uint8
    TpDataStateType: compu {0=TP_DATACONF, 1=TP_DATARETRY, 2=TP_CONFPENDING}, implementation-data-type=ImplementationDataTypes/uint32
    RetryInfoType: category=STRUCTURE
      element TpDataState: implementation-data-type=ImplementationDataTypes/TpDataStateType
      element TxTpDataCnt: implementation-data-type=ImplementationDataTypes/PduLengthType
    NetworkHandleType: implementation-data-type=ImplementationDataTypes/uint8
package /AUTOSAR/Can/ImplementationDataTypes
  5 x impl type, all with type-emitter=BSW:
    Can_IdType: implementation-data-type=ImplementationDataTypes/uint32
    Can_HwHandleType: implementation-data-type=ImplementationDataTypes/uint8
    Can_PduType: category=STRUCTURE
      4 x element:
        id: implementation-data-type=ImplementationDataTypes/Can_IdType
        length: implementation-data-type=ImplementationDataTypes/uint8
        sdu: category=DATA_REFERENCE, sw-pointer-target-props={target-category=TYPE_REFERENCE, implementation-data-type=ImplementationDataTypes/uint8}
        swPduHandle: implementation-data-type=ImplementationDataTypes/PduIdType
    Can_StateTransitionType: compu {0=CAN_T_START, 1=CAN_T_STOP, 2=CAN_T_SLEEP, 3=CAN_T_WAKEUP}, implementation-data-type=ImplementationDataTypes/uint32
    Can_ReturnType: compu {0=CAN_OK, 1=CAN_NOT_OK, 2=CAN_BUSY}, implementation-data-type=ImplementationDataTypes/uint32
package /AUTOSAR/CanTrcv/ImplementationDataTypes
  5 x impl type, all with category=TYPE_REFERENCE, implementation-data-type=ImplementationDataTypes/uint32, type-emitter=BSW:
    CanTrcv_TrcvModeType: compu-method=CanTrcv_TrcvModeType_Literals
    CanTrcv_TrcvWakeupReasonType: compu-method=CanTrcv_TrcvWakeupReasonType_Literals
    CanTrcv_TrcvWakeupModeType: compu-method=CanTrcv_TrcvWakeupModeType_Literals
    CanTrcv_PNActivationType: compu {0=PN_ENABLED, 1=PN_DISABLED}
    CanTrcv_TrcvFlagStateType: compu {0=CANTRCV_FLAG_SET, 1=CANTRCV_FLAG_CLEARED}
package /AUTOSAR/Lin/ImplementationDataTypes
  6 x impl type, all with type-emitter=BSW:
    Lin_FramePidType: implementation-data-type=ImplementationDataTypes/uint8
    Lin_FrameCsModelType: compu {0=LIN_ENHANCED_CS, 1=LIN_CLASSIC_CS}, implementation-data-type=ImplementationDataTypes/uint32
    Lin_FrameResponseType: compu {0=LIN_MASTER_RESPONSE, 1=LIN_SLAVE_RESPONSE, 2=LIN_SLAVE_TO_SLAVE}, implementation-data-type=ImplementationDataTypes/uint32
    Lin_FrameDlType: implementation-data-type=ImplementationDataTypes/uint8
    Lin_PduType: category=STRUCTURE
      5 x element:
        Pid: implementation-data-type=ImplementationDataTypes/Lin_FramePidType
        Cs: implementation-data-type=ImplementationDataTypes/Lin_FrameCsModelType
        Drc: implementation-data-type=ImplementationDataTypes/Lin_FrameResponseType
        Dl: implementation-data-type=ImplementationDataTypes/Lin_FrameDlType
        SduPtr: category=DATA_REFERENCE, sw-pointer-target-props={target-category=TYPE_REFERENCE, implementation-data-type=ImplementationDataTypes/uint8}
    Lin_StatusType: compu-method=Lin_StatusType_Literals, implementation-data-type=ImplementationDataTypes/uint32
package /AUTOSAR/LinTrcv/ImplementationDataTypes
  impl type LinTrcv_TrcvModeType: compu-method=LinTrcv_TrcvModeType_Literals, implementation-data-type=ImplementationDataTypes/uint32, type-emitter=BSW
  impl type LinTrcv_TrcvWakeupModeType: compu-method=LinTrcv_TrcvWakeupModeType_Literals, implementation-data-type=ImplementationDataTypes/uint32, type-emitter=BSW
  impl type LinTrcv_TrcvWakeupReasonType: compu-method=LinTrcv_TrcvWakeupReasonType_Literals, implementation-data-type=ImplementationDataTypes/uint32, type-emitter=BSW
package /AUTOSAR/MemMap/SwAddrMethods
  12 x sw addr method:
    CODE: memory-allocation-keyword-policy=ADDR-METHOD-SHORT-NAME, section-type=CODE
    CALLOUT_CODE: memory-allocation-keyword-policy=ADDR-METHOD-SHORT-NAME, section-type=CODE
    VAR: memory-allocation-keyword-policy=ADDR-METHOD-SHORT-NAME-AND-ALIGNMENT, section-initialization-policy=INIT, section-type=VAR
    VAR_INIT: memory-allocation-keyword-policy=ADDR-METHOD-SHORT-NAME-AND-ALIGNMENT, section-initialization-policy=INIT, section-type=VAR
    VAR_NOINIT: memory-allocation-keyword-policy=ADDR-METHOD-SHORT-NAME-AND-ALIGNMENT, section-initialization-policy=NO-INIT, section-type=VAR
    VAR_CLEARED: memory-allocation-keyword-policy=ADDR-METHOD-SHORT-NAME-AND-ALIGNMENT, section-initialization-policy=CLEARED, section-type=VAR
    VAR_POWER_ON_INIT: memory-allocation-keyword-policy=ADDR-METHOD-SHORT-NAME-AND-ALIGNMENT, section-initialization-policy=POWER-ON-INIT, section-type=VAR
    VAR_POWER_ON_CLEARED: memory-allocation-keyword-policy=ADDR-METHOD-SHORT-NAME-AND-ALIGNMENT, section-initialization-policy=POWER-ON-CLEARED, section-type=VAR
    VAR_FAST: memory-allocation-keyword-policy=ADDR-METHOD-SHORT-NAME-AND-ALIGNMENT, section-initialization-policy=INIT, section-type=VAR-FAST
    CONST: memory-allocation-keyword-policy=ADDR-METHOD-SHORT-NAME-AND-ALIGNMENT, section-type=CONST
    CALIB: memory-allocation-keyword-policy=ADDR-METHOD-SHORT-NAME-AND-ALIGNMENT, section-initialization-policy=INIT, section-type=CALPRM
    CONFIG_DATA: memory-allocation-keyword-policy=ADDR-METHOD-SHORT-NAME-AND-ALIGNMENT, section-type=CONFIG-DATA
package /AUTOSAR_Base/BswModuleDescriptions
  bsw module description Base: module-id=0, provided-entrys=TS_PlatformSigIsValid
    bsw internal behavior InternalBehavior_0
      bsw called entity TS_PlatformSigIsValid: implemented-entry=TS_PlatformSigIsValid
package /AUTOSAR_Base/BswModuleEntrys
  bsw module entry TS_PlatformSigIsValid: is-reentrant=false, is-synchronous=true, call-type=REGULAR, execution-context=TASK, sw-service-impl-policy=STANDARD
package /EB_Base_TxDxM5I0R0/Implementations
  bsw implementation BswImplementation_0: programming-language=C, sw-version=5.0.19, vendor-id=1, ar-release-version=4.0.3, behavior=InternalBehavior_0, vendor-specific-module-def=Base
    code-descriptors:
      code Files
        artifact-descriptors:
          short-label=Autosar::include::Can_GeneralTypes.h, category=SWHDR
          short-label=Autosar::include::Eth_GeneralTypes.h, category=SWHDR
          short-label=Autosar::include::Fr_GeneralTypes.h, category=SWHDR
          short-label=Autosar::include::Lin_GeneralTypes.h, category=SWHDR
          short-label=Autosar::include::TSAtomic_Assign.h, category=SWHDR
          short-label=Autosar::include::TSAutosar.h, category=SWHDR
          short-label=Autosar::include::TSCompiler_Default.h, category=SWHDR
          short-label=Autosar::include::TSMem.h, category=SWHDR
          short-label=Autosar::include::TSPBConfig.h, category=SWHDR
          short-label=Autosar::include::TSPBConfig_Access.h, category=SWHDR
          short-label=Autosar::include::TSPBConfig_BasicTypes.h, category=SWHDR
          short-label=Autosar::include::TSPBConfig_Init.h, category=SWHDR
          short-label=Autosar::include::TSPBConfig_OffsetAlignment.h, category=SWHDR
          short-label=Autosar::include::TSPBConfig_Signature.h, category=SWHDR
          short-label=Autosar::include::TSPBConfig_Types.h, category=SWHDR
          short-label=Autosar::include::TransformerTypes.h, category=SWHDR
          short-label=Autosar::include::ComStack_Types.h, category=SWHDR
          short-label=Autosar::include::Compiler_Common.h, category=SWHDR
          short-label=Autosar::include::Std_Types.h, category=SWHDR
          short-label=Autosar::src::TSMem.c, category=SWSRC
          short-label=Autosar::src::TSPBConfig.c, category=SWSRC
          short-label=make::Base_defs.mak, category=SWMAKE
          short-label=make::Base_rules.mak, category=SWMAKE
    resource consumption ResourceConsumption
      memory section CODE: sw-addrmethod=SwAddrMethods/CODE
