AUTOSAR XML (schema 4-0-3)
package /AUTOSAR_BswM/BswModuleDescriptions
  bsw module description BswM: module-id=042
    provided-entrys:
      BswM_MainFunction
      BswM_Init
      BswM_MRPFunc_MasterCoreAppMode_APP_SYNC_INIT
      BswM_MRPFunc_SlaveCoreBswMMode_BSWM_GO_SLEEP_ONE
      BswM_MRPFunc_SlaveCoreBswMMode_BSWM_STARTUP_TWO_A
      BswM_MRPFunc_MasterCoreBswMMode_BSWM_STARTUP_TWO_A
      BswM_MRPFunc_MasterCoreBswMMode_BSWM_PRP_SHUTDOWN
      BswM_MRPFunc_MasterCoreBswMMode_BSWM_STARTUP_TWO_B
      BswM_MRPFunc_SlaveCoreBswMMode_BSWM_RUN_TWO
      BswM_MRPFunc_SlaveCoreBswMMode_BSWM_WAKEUP_TWO
      BswM_MRPFunc_SlaveCoreBswMMode_BSWM_STARTUP_TWO_B
      BswM_MRPFunc_SlaveCoreAppMode_APP_WAKEUP
      BswM_MRPFunc_MasterCoreAppMode_APP_ON
      BswM_MRPFunc_SlaveCoreBswMMode_BSWM_PRP_SHUTDOWN
      BswM_MRPFunc_SlaveCoreBswMMode_BSWM_GO_OFF_ONE_A
      BswM_MRPFunc_SlaveCoreAppMode_APP_SYNC_INIT
      BswM_MRPFunc_MasterCoreBswMMode_BSWM_GO_OFF_ONE_A
      BswM_MRPFunc_SlaveCoreAppMode_APP_OFF
      BswM_MRPFunc_MasterCoreBswMMode_BSWM_GO_SLEEP_ONE
      BswM_MRPFunc_SlaveCoreAppMode_APP_ON
      BswM_MRPFunc_MasterCoreAppMode_APP_CONFIG
      BswM_MRPFunc_MasterCoreBswMMode_BSWM_WAKEUP_TWO
      BswM_MRPFunc_MasterCoreAppMode_APP_WAKEUP
      BswM_MRPFunc_MasterCoreAppMode_APP_OFF
      BswM_MRPFunc_SlaveCoreAppMode_APP_CONFIG
      BswM_MRPFunc_MasterCoreBswMMode_BSWM_RUN_TWO
    provided-mode-groups:
      8 x mode declaration group prototype:
        BswM_ModeSwitchPort_OsApp_CORE0_QM_BswMSwitchPort_Rte: type=BswMModeGroup
        BswM_ModeSwitchPort_OsApp_CORE0_QM_BswMSwitchLocalPort_Rte: type=BswMModeGroup
        BswM_ModeSwitchPort_OsApp_CORE0_QM_AppSwitchPort_Rte: type=ApplicationModeGroup
        BswM_ModeSwitchPort_OsApp_CORE0_QM_AppSwitchLocalPort_Rte: type=ApplicationModeGroup
        BswM_ModeSwitchPort_OsApp_CORE1_QM_BswMSwitchPort_SlaveCore_Rte: type=BswMModeGroup
        BswM_ModeSwitchPort_OsApp_CORE1_QM_BswMSwitchLocalPort_SlaveCore_Rte: type=BswMModeGroup
        BswM_ModeSwitchPort_OsApp_CORE1_QM_AppSwitchPort_Rte: type=ApplicationModeGroup
        BswM_ModeSwitchPort_OsApp_CORE1_QM_AppSwitchLocalPort_Rte: type=ApplicationModeGroup
    required-mode-groups:
      8 x mode declaration group prototype:
        BswM_ModeNotificationPort_OsApp_CORE0_QM_MasterCoreBswMMode: type=BswMModeGroup
        BswM_ModeNotificationPort_OsApp_CORE0_QM_MasterCoreAppMode: type=ApplicationModeGroup
        BswM_ModeNotificationPort_OsApp_CORE0_QM_SlaveCoreBswMMode: type=BswMModeGroup
        BswM_ModeNotificationPort_OsApp_CORE0_QM_SlaveCoreAppMode: type=ApplicationModeGroup
        BswM_ModeNotificationPort_OsApp_CORE1_QM_MasterCoreBswMMode: type=BswMModeGroup
        BswM_ModeNotificationPort_OsApp_CORE1_QM_MasterCoreAppMode: type=ApplicationModeGroup
        BswM_ModeNotificationPort_OsApp_CORE1_QM_SlaveCoreBswMMode: type=BswMModeGroup
        BswM_ModeNotificationPort_OsApp_CORE1_QM_SlaveCoreAppMode: type=ApplicationModeGroup
    bsw internal behavior InternalBehavior_0: data-type-mapping=[ApplicationModeMapping, BswMModeMapping]
      exclusive area SCHM_BSWM_EXCLUSIVE_AREA
      25 x bsw schedulable entity:
        SE_MasterCoreBswMMode_BSWM_GO_OFF_ONE_A: accessed-mode-groups=BswM_ModeNotificationPort_OsApp_CORE0_QM_MasterCoreBswMMode, implemented-entry=BswM_MRPFunc_MasterCoreBswMMode_BSWM_GO_OFF_ONE_A
        SE_MasterCoreBswMMode_BSWM_GO_SLEEP_ONE: accessed-mode-groups=BswM_ModeNotificationPort_OsApp_CORE0_QM_MasterCoreBswMMode, implemented-entry=BswM_MRPFunc_MasterCoreBswMMode_BSWM_GO_SLEEP_ONE
        SE_MasterCoreBswMMode_BSWM_PRP_SHUTDOWN: accessed-mode-groups=BswM_ModeNotificationPort_OsApp_CORE0_QM_MasterCoreBswMMode, implemented-entry=BswM_MRPFunc_MasterCoreBswMMode_BSWM_PRP_SHUTDOWN
        SE_MasterCoreBswMMode_BSWM_RUN_TWO: accessed-mode-groups=BswM_ModeNotificationPort_OsApp_CORE0_QM_MasterCoreBswMMode, implemented-entry=BswM_MRPFunc_MasterCoreBswMMode_BSWM_RUN_TWO
        SE_MasterCoreBswMMode_BSWM_STARTUP_TWO_A: accessed-mode-groups=BswM_ModeNotificationPort_OsApp_CORE0_QM_MasterCoreBswMMode, implemented-entry=BswM_MRPFunc_MasterCoreBswMMode_BSWM_STARTUP_TWO_A
        SE_MasterCoreBswMMode_BSWM_STARTUP_TWO_B: accessed-mode-groups=BswM_ModeNotificationPort_OsApp_CORE0_QM_MasterCoreBswMMode, implemented-entry=BswM_MRPFunc_MasterCoreBswMMode_BSWM_STARTUP_TWO_B
        SE_MasterCoreBswMMode_BSWM_WAKEUP_TWO: accessed-mode-groups=BswM_ModeNotificationPort_OsApp_CORE0_QM_MasterCoreBswMMode, implemented-entry=BswM_MRPFunc_MasterCoreBswMMode_BSWM_WAKEUP_TWO
        SE_MasterCoreAppMode_APP_CONFIG: accessed-mode-groups=BswM_ModeNotificationPort_OsApp_CORE0_QM_MasterCoreAppMode, implemented-entry=BswM_MRPFunc_MasterCoreAppMode_APP_CONFIG
        SE_MasterCoreAppMode_APP_OFF: accessed-mode-groups=BswM_ModeNotificationPort_OsApp_CORE0_QM_MasterCoreAppMode, implemented-entry=BswM_MRPFunc_MasterCoreAppMode_APP_OFF
        SE_MasterCoreAppMode_APP_ON: accessed-mode-groups=BswM_ModeNotificationPort_OsApp_CORE0_QM_MasterCoreAppMode, implemented-entry=BswM_MRPFunc_MasterCoreAppMode_APP_ON
        SE_MasterCoreAppMode_APP_SYNC_INIT: accessed-mode-groups=BswM_ModeNotificationPort_OsApp_CORE0_QM_MasterCoreAppMode, implemented-entry=BswM_MRPFunc_MasterCoreAppMode_APP_SYNC_INIT
        SE_MasterCoreAppMode_APP_WAKEUP: accessed-mode-groups=BswM_ModeNotificationPort_OsApp_CORE0_QM_MasterCoreAppMode, implemented-entry=BswM_MRPFunc_MasterCoreAppMode_APP_WAKEUP
        SE_SlaveCoreBswMMode_BSWM_GO_OFF_ONE_A: accessed-mode-groups=BswM_ModeNotificationPort_OsApp_CORE0_QM_SlaveCoreBswMMode, implemented-entry=BswM_MRPFunc_SlaveCoreBswMMode_BSWM_GO_OFF_ONE_A
        SE_SlaveCoreBswMMode_BSWM_GO_SLEEP_ONE: accessed-mode-groups=BswM_ModeNotificationPort_OsApp_CORE0_QM_SlaveCoreBswMMode, implemented-entry=BswM_MRPFunc_SlaveCoreBswMMode_BSWM_GO_SLEEP_ONE
        SE_SlaveCoreBswMMode_BSWM_PRP_SHUTDOWN: accessed-mode-groups=BswM_ModeNotificationPort_OsApp_CORE0_QM_SlaveCoreBswMMode, implemented-entry=BswM_MRPFunc_SlaveCoreBswMMode_BSWM_PRP_SHUTDOWN
        SE_SlaveCoreBswMMode_BSWM_RUN_TWO: accessed-mode-groups=BswM_ModeNotificationPort_OsApp_CORE0_QM_SlaveCoreBswMMode, implemented-entry=BswM_MRPFunc_SlaveCoreBswMMode_BSWM_RUN_TWO
        SE_SlaveCoreBswMMode_BSWM_STARTUP_TWO_A: accessed-mode-groups=BswM_ModeNotificationPort_OsApp_CORE0_QM_SlaveCoreBswMMode, implemented-entry=BswM_MRPFunc_SlaveCoreBswMMode_BSWM_STARTUP_TWO_A
        SE_SlaveCoreBswMMode_BSWM_STARTUP_TWO_B: accessed-mode-groups=BswM_ModeNotificationPort_OsApp_CORE0_QM_SlaveCoreBswMMode, implemented-entry=BswM_MRPFunc_SlaveCoreBswMMode_BSWM_STARTUP_TWO_B
        SE_SlaveCoreBswMMode_BSWM_WAKEUP_TWO: accessed-mode-groups=BswM_ModeNotificationPort_OsApp_CORE0_QM_SlaveCoreBswMMode, implemented-entry=BswM_MRPFunc_SlaveCoreBswMMode_BSWM_WAKEUP_TWO
        SE_SlaveCoreAppMode_APP_CONFIG: accessed-mode-groups=BswM_ModeNotificationPort_OsApp_CORE0_QM_SlaveCoreAppMode, implemented-entry=BswM_MRPFunc_SlaveCoreAppMode_APP_CONFIG
        SE_SlaveCoreAppMode_APP_OFF: accessed-mode-groups=BswM_ModeNotificationPort_OsApp_CORE0_QM_SlaveCoreAppMode, implemented-entry=BswM_MRPFunc_SlaveCoreAppMode_APP_OFF
        SE_SlaveCoreAppMode_APP_ON: accessed-mode-groups=BswM_ModeNotificationPort_OsApp_CORE0_QM_SlaveCoreAppMode, implemented-entry=BswM_MRPFunc_SlaveCoreAppMode_APP_ON
        SE_SlaveCoreAppMode_APP_SYNC_INIT: accessed-mode-groups=BswM_ModeNotificationPort_OsApp_CORE0_QM_SlaveCoreAppMode, implemented-entry=BswM_MRPFunc_SlaveCoreAppMode_APP_SYNC_INIT
        SE_SlaveCoreAppMode_APP_WAKEUP: accessed-mode-groups=BswM_ModeNotificationPort_OsApp_CORE0_QM_SlaveCoreAppMode, implemented-entry=BswM_MRPFunc_SlaveCoreAppMode_APP_WAKEUP
        BswM_MainFunction: can-enter-exclusive-area=InternalBehavior_0/SCHM_BSWM_EXCLUSIVE_AREA, implemented-entry=BswM_MainFunction
          managed-mode-groups:
            BswM_ModeSwitchPort_OsApp_CORE0_QM_BswMSwitchPort_Rte
            BswM_ModeSwitchPort_OsApp_CORE0_QM_BswMSwitchLocalPort_Rte
            BswM_ModeSwitchPort_OsApp_CORE0_QM_AppSwitchPort_Rte
            BswM_ModeSwitchPort_OsApp_CORE0_QM_AppSwitchLocalPort_Rte
      24 x bsw mode switch event, all with activation=ON-ENTRY:
        MSE_MasterCoreBswMMode_BSWM_GO_OFF_ONE_A: starts-on-event=InternalBehavior_0/SE_MasterCoreBswMMode_BSWM_GO_OFF_ONE_A, mode=BswM_ModeNotificationPort_OsApp_CORE0_QM_MasterCoreBswMMode.BSWM_GO_OFF_ONE_A
        MSE_MasterCoreBswMMode_BSWM_GO_SLEEP_ONE: starts-on-event=InternalBehavior_0/SE_MasterCoreBswMMode_BSWM_GO_SLEEP_ONE, mode=BswM_ModeNotificationPort_OsApp_CORE0_QM_MasterCoreBswMMode.BSWM_GO_SLEEP_ONE
        MSE_MasterCoreBswMMode_BSWM_PRP_SHUTDOWN: starts-on-event=InternalBehavior_0/SE_MasterCoreBswMMode_BSWM_PRP_SHUTDOWN, mode=BswM_ModeNotificationPort_OsApp_CORE0_QM_MasterCoreBswMMode.BSWM_PRP_SHUTDOWN
        MSE_MasterCoreBswMMode_BSWM_RUN_TWO: starts-on-event=InternalBehavior_0/SE_MasterCoreBswMMode_BSWM_RUN_TWO, mode=BswM_ModeNotificationPort_OsApp_CORE0_QM_MasterCoreBswMMode.BSWM_RUN_TWO
        MSE_MasterCoreBswMMode_BSWM_STARTUP_TWO_A: starts-on-event=InternalBehavior_0/SE_MasterCoreBswMMode_BSWM_STARTUP_TWO_A, mode=BswM_ModeNotificationPort_OsApp_CORE0_QM_MasterCoreBswMMode.BSWM_STARTUP_TWO_A
        MSE_MasterCoreBswMMode_BSWM_STARTUP_TWO_B: starts-on-event=InternalBehavior_0/SE_MasterCoreBswMMode_BSWM_STARTUP_TWO_B, mode=BswM_ModeNotificationPort_OsApp_CORE0_QM_MasterCoreBswMMode.BSWM_STARTUP_TWO_B
        MSE_MasterCoreBswMMode_BSWM_WAKEUP_TWO: starts-on-event=InternalBehavior_0/SE_MasterCoreBswMMode_BSWM_WAKEUP_TWO, mode=BswM_ModeNotificationPort_OsApp_CORE0_QM_MasterCoreBswMMode.BSWM_WAKEUP_TWO
        MSE_MasterCoreAppMode_APP_CONFIG: starts-on-event=InternalBehavior_0/SE_MasterCoreAppMode_APP_CONFIG, mode=BswM_ModeNotificationPort_OsApp_CORE0_QM_MasterCoreAppMode.APP_CONFIG
        MSE_MasterCoreAppMode_APP_OFF: starts-on-event=InternalBehavior_0/SE_MasterCoreAppMode_APP_OFF, mode=BswM_ModeNotificationPort_OsApp_CORE0_QM_MasterCoreAppMode.APP_OFF
        MSE_MasterCoreAppMode_APP_ON: starts-on-event=InternalBehavior_0/SE_MasterCoreAppMode_APP_ON, mode=BswM_ModeNotificationPort_OsApp_CORE0_QM_MasterCoreAppMode.APP_ON
        MSE_MasterCoreAppMode_APP_SYNC_INIT: starts-on-event=InternalBehavior_0/SE_MasterCoreAppMode_APP_SYNC_INIT, mode=BswM_ModeNotificationPort_OsApp_CORE0_QM_MasterCoreAppMode.APP_SYNC_INIT
        MSE_MasterCoreAppMode_APP_WAKEUP: starts-on-event=InternalBehavior_0/SE_MasterCoreAppMode_APP_WAKEUP, mode=BswM_ModeNotificationPort_OsApp_CORE0_QM_MasterCoreAppMode.APP_WAKEUP
        MSE_SlaveCoreBswMMode_BSWM_GO_OFF_ONE_A: starts-on-event=InternalBehavior_0/SE_SlaveCoreBswMMode_BSWM_GO_OFF_ONE_A, mode=BswM_ModeNotificationPort_OsApp_CORE0_QM_SlaveCoreBswMMode.BSWM_GO_OFF_ONE_A
        MSE_SlaveCoreBswMMode_BSWM_GO_SLEEP_ONE: starts-on-event=InternalBehavior_0/SE_SlaveCoreBswMMode_BSWM_GO_SLEEP_ONE, mode=BswM_ModeNotificationPort_OsApp_CORE0_QM_SlaveCoreBswMMode.BSWM_GO_SLEEP_ONE
        MSE_SlaveCoreBswMMode_BSWM_PRP_SHUTDOWN: starts-on-event=InternalBehavior_0/SE_SlaveCoreBswMMode_BSWM_PRP_SHUTDOWN, mode=BswM_ModeNotificationPort_OsApp_CORE0_QM_SlaveCoreBswMMode.BSWM_PRP_SHUTDOWN
        MSE_SlaveCoreBswMMode_BSWM_RUN_TWO: starts-on-event=InternalBehavior_0/SE_SlaveCoreBswMMode_BSWM_RUN_TWO, mode=BswM_ModeNotificationPort_OsApp_CORE0_QM_SlaveCoreBswMMode.BSWM_RUN_TWO
        MSE_SlaveCoreBswMMode_BSWM_STARTUP_TWO_A: starts-on-event=InternalBehavior_0/SE_SlaveCoreBswMMode_BSWM_STARTUP_TWO_A, mode=BswM_ModeNotificationPort_OsApp_CORE0_QM_SlaveCoreBswMMode.BSWM_STARTUP_TWO_A
        MSE_SlaveCoreBswMMode_BSWM_STARTUP_TWO_B: starts-on-event=InternalBehavior_0/SE_SlaveCoreBswMMode_BSWM_STARTUP_TWO_B, mode=BswM_ModeNotificationPort_OsApp_CORE0_QM_SlaveCoreBswMMode.BSWM_STARTUP_TWO_B
        MSE_SlaveCoreBswMMode_BSWM_WAKEUP_TWO: starts-on-event=InternalBehavior_0/SE_SlaveCoreBswMMode_BSWM_WAKEUP_TWO, mode=BswM_ModeNotificationPort_OsApp_CORE0_QM_SlaveCoreBswMMode.BSWM_WAKEUP_TWO
        MSE_SlaveCoreAppMode_APP_CONFIG: starts-on-event=InternalBehavior_0/SE_SlaveCoreAppMode_APP_CONFIG, mode=BswM_ModeNotificationPort_OsApp_CORE0_QM_SlaveCoreAppMode.APP_CONFIG
        MSE_SlaveCoreAppMode_APP_OFF: starts-on-event=InternalBehavior_0/SE_SlaveCoreAppMode_APP_OFF, mode=BswM_ModeNotificationPort_OsApp_CORE0_QM_SlaveCoreAppMode.APP_OFF
        MSE_SlaveCoreAppMode_APP_ON: starts-on-event=InternalBehavior_0/SE_SlaveCoreAppMode_APP_ON, mode=BswM_ModeNotificationPort_OsApp_CORE0_QM_SlaveCoreAppMode.APP_ON
        MSE_SlaveCoreAppMode_APP_SYNC_INIT: starts-on-event=InternalBehavior_0/SE_SlaveCoreAppMode_APP_SYNC_INIT, mode=BswM_ModeNotificationPort_OsApp_CORE0_QM_SlaveCoreAppMode.APP_SYNC_INIT
        MSE_SlaveCoreAppMode_APP_WAKEUP: starts-on-event=InternalBehavior_0/SE_SlaveCoreAppMode_APP_WAKEUP, mode=BswM_ModeNotificationPort_OsApp_CORE0_QM_SlaveCoreAppMode.APP_WAKEUP
      bsw timing event TimingEvent_MainFunction: starts-on-event=InternalBehavior_0/BswM_MainFunction, period=0.01
    bsw internal behavior InternalBehavior_1: data-type-mapping=[ApplicationModeMapping, BswMModeMapping]
      exclusive area SCHM_BSWM_EXCLUSIVE_AREA
      25 x bsw schedulable entity:
        SE_MasterCoreBswMMode_BSWM_GO_OFF_ONE_A: accessed-mode-groups=BswM_ModeNotificationPort_OsApp_CORE1_QM_MasterCoreBswMMode, implemented-entry=BswM_MRPFunc_MasterCoreBswMMode_BSWM_GO_OFF_ONE_A
        SE_MasterCoreBswMMode_BSWM_GO_SLEEP_ONE: accessed-mode-groups=BswM_ModeNotificationPort_OsApp_CORE1_QM_MasterCoreBswMMode, implemented-entry=BswM_MRPFunc_MasterCoreBswMMode_BSWM_GO_SLEEP_ONE
        SE_MasterCoreBswMMode_BSWM_PRP_SHUTDOWN: accessed-mode-groups=BswM_ModeNotificationPort_OsApp_CORE1_QM_MasterCoreBswMMode, implemented-entry=BswM_MRPFunc_MasterCoreBswMMode_BSWM_PRP_SHUTDOWN
        SE_MasterCoreBswMMode_BSWM_RUN_TWO: accessed-mode-groups=BswM_ModeNotificationPort_OsApp_CORE1_QM_MasterCoreBswMMode, implemented-entry=BswM_MRPFunc_MasterCoreBswMMode_BSWM_RUN_TWO
        SE_MasterCoreBswMMode_BSWM_STARTUP_TWO_A: accessed-mode-groups=BswM_ModeNotificationPort_OsApp_CORE1_QM_MasterCoreBswMMode, implemented-entry=BswM_MRPFunc_MasterCoreBswMMode_BSWM_STARTUP_TWO_A
        SE_MasterCoreBswMMode_BSWM_STARTUP_TWO_B: accessed-mode-groups=BswM_ModeNotificationPort_OsApp_CORE1_QM_MasterCoreBswMMode, implemented-entry=BswM_MRPFunc_MasterCoreBswMMode_BSWM_STARTUP_TWO_B
        SE_MasterCoreBswMMode_BSWM_WAKEUP_TWO: accessed-mode-groups=BswM_ModeNotificationPort_OsApp_CORE1_QM_MasterCoreBswMMode, implemented-entry=BswM_MRPFunc_MasterCoreBswMMode_BSWM_WAKEUP_TWO
        SE_MasterCoreAppMode_APP_CONFIG: accessed-mode-groups=BswM_ModeNotificationPort_OsApp_CORE1_QM_MasterCoreAppMode, implemented-entry=BswM_MRPFunc_MasterCoreAppMode_APP_CONFIG
        SE_MasterCoreAppMode_APP_OFF: accessed-mode-groups=BswM_ModeNotificationPort_OsApp_CORE1_QM_MasterCoreAppMode, implemented-entry=BswM_MRPFunc_MasterCoreAppMode_APP_OFF
        SE_MasterCoreAppMode_APP_ON: accessed-mode-groups=BswM_ModeNotificationPort_OsApp_CORE1_QM_MasterCoreAppMode, implemented-entry=BswM_MRPFunc_MasterCoreAppMode_APP_ON
        SE_MasterCoreAppMode_APP_SYNC_INIT: accessed-mode-groups=BswM_ModeNotificationPort_OsApp_CORE1_QM_MasterCoreAppMode, implemented-entry=BswM_MRPFunc_MasterCoreAppMode_APP_SYNC_INIT
        SE_MasterCoreAppMode_APP_WAKEUP: accessed-mode-groups=BswM_ModeNotificationPort_OsApp_CORE1_QM_MasterCoreAppMode, implemented-entry=BswM_MRPFunc_MasterCoreAppMode_APP_WAKEUP
        SE_SlaveCoreBswMMode_BSWM_GO_OFF_ONE_A: accessed-mode-groups=BswM_ModeNotificationPort_OsApp_CORE1_QM_SlaveCoreBswMMode, implemented-entry=BswM_MRPFunc_SlaveCoreBswMMode_BSWM_GO_OFF_ONE_A
        SE_SlaveCoreBswMMode_BSWM_GO_SLEEP_ONE: accessed-mode-groups=BswM_ModeNotificationPort_OsApp_CORE1_QM_SlaveCoreBswMMode, implemented-entry=BswM_MRPFunc_SlaveCoreBswMMode_BSWM_GO_SLEEP_ONE
        SE_SlaveCoreBswMMode_BSWM_PRP_SHUTDOWN: accessed-mode-groups=BswM_ModeNotificationPort_OsApp_CORE1_QM_SlaveCoreBswMMode, implemented-entry=BswM_MRPFunc_SlaveCoreBswMMode_BSWM_PRP_SHUTDOWN
        SE_SlaveCoreBswMMode_BSWM_RUN_TWO: accessed-mode-groups=BswM_ModeNotificationPort_OsApp_CORE1_QM_SlaveCoreBswMMode, implemented-entry=BswM_MRPFunc_SlaveCoreBswMMode_BSWM_RUN_TWO
        SE_SlaveCoreBswMMode_BSWM_STARTUP_TWO_A: accessed-mode-groups=BswM_ModeNotificationPort_OsApp_CORE1_QM_SlaveCoreBswMMode, implemented-entry=BswM_MRPFunc_SlaveCoreBswMMode_BSWM_STARTUP_TWO_A
        SE_SlaveCoreBswMMode_BSWM_STARTUP_TWO_B: accessed-mode-groups=BswM_ModeNotificationPort_OsApp_CORE1_QM_SlaveCoreBswMMode, implemented-entry=BswM_MRPFunc_SlaveCoreBswMMode_BSWM_STARTUP_TWO_B
        SE_SlaveCoreBswMMode_BSWM_WAKEUP_TWO: accessed-mode-groups=BswM_ModeNotificationPort_OsApp_CORE1_QM_SlaveCoreBswMMode, implemented-entry=BswM_MRPFunc_SlaveCoreBswMMode_BSWM_WAKEUP_TWO
        SE_SlaveCoreAppMode_APP_CONFIG: accessed-mode-groups=BswM_ModeNotificationPort_OsApp_CORE1_QM_SlaveCoreAppMode, implemented-entry=BswM_MRPFunc_SlaveCoreAppMode_APP_CONFIG
        SE_SlaveCoreAppMode_APP_OFF: accessed-mode-groups=BswM_ModeNotificationPort_OsApp_CORE1_QM_SlaveCoreAppMode, implemented-entry=BswM_MRPFunc_SlaveCoreAppMode_APP_OFF
        SE_SlaveCoreAppMode_APP_ON: accessed-mode-groups=BswM_ModeNotificationPort_OsApp_CORE1_QM_SlaveCoreAppMode, implemented-entry=BswM_MRPFunc_SlaveCoreAppMode_APP_ON
        SE_SlaveCoreAppMode_APP_SYNC_INIT: accessed-mode-groups=BswM_ModeNotificationPort_OsApp_CORE1_QM_SlaveCoreAppMode, implemented-entry=BswM_MRPFunc_SlaveCoreAppMode_APP_SYNC_INIT
        SE_SlaveCoreAppMode_APP_WAKEUP: accessed-mode-groups=BswM_ModeNotificationPort_OsApp_CORE1_QM_SlaveCoreAppMode, implemented-entry=BswM_MRPFunc_SlaveCoreAppMode_APP_WAKEUP
        BswM_MainFunction: can-enter-exclusive-area=InternalBehavior_1/SCHM_BSWM_EXCLUSIVE_AREA, implemented-entry=BswM_MainFunction
          managed-mode-groups:
            BswM_ModeSwitchPort_OsApp_CORE1_QM_BswMSwitchPort_SlaveCore_Rte
            BswM_ModeSwitchPort_OsApp_CORE1_QM_BswMSwitchLocalPort_SlaveCore_Rte
            BswM_ModeSwitchPort_OsApp_CORE1_QM_AppSwitchPort_Rte
            BswM_ModeSwitchPort_OsApp_CORE1_QM_AppSwitchLocalPort_Rte
      24 x bsw mode switch event, all with activation=ON-ENTRY:
        MSE_MasterCoreBswMMode_BSWM_GO_OFF_ONE_A: starts-on-event=InternalBehavior_1/SE_MasterCoreBswMMode_BSWM_GO_OFF_ONE_A, mode=BswM_ModeNotificationPort_OsApp_CORE1_QM_MasterCoreBswMMode.BSWM_GO_OFF_ONE_A
        MSE_MasterCoreBswMMode_BSWM_GO_SLEEP_ONE: starts-on-event=InternalBehavior_1/SE_MasterCoreBswMMode_BSWM_GO_SLEEP_ONE, mode=BswM_ModeNotificationPort_OsApp_CORE1_QM_MasterCoreBswMMode.BSWM_GO_SLEEP_ONE
        MSE_MasterCoreBswMMode_BSWM_PRP_SHUTDOWN: starts-on-event=InternalBehavior_1/SE_MasterCoreBswMMode_BSWM_PRP_SHUTDOWN, mode=BswM_ModeNotificationPort_OsApp_CORE1_QM_MasterCoreBswMMode.BSWM_PRP_SHUTDOWN
        MSE_MasterCoreBswMMode_BSWM_RUN_TWO: starts-on-event=InternalBehavior_1/SE_MasterCoreBswMMode_BSWM_RUN_TWO, mode=BswM_ModeNotificationPort_OsApp_CORE1_QM_MasterCoreBswMMode.BSWM_RUN_TWO
        MSE_MasterCoreBswMMode_BSWM_STARTUP_TWO_A: starts-on-event=InternalBehavior_1/SE_MasterCoreBswMMode_BSWM_STARTUP_TWO_A, mode=BswM_ModeNotificationPort_OsApp_CORE1_QM_MasterCoreBswMMode.BSWM_STARTUP_TWO_A
        MSE_MasterCoreBswMMode_BSWM_STARTUP_TWO_B: starts-on-event=InternalBehavior_1/SE_MasterCoreBswMMode_BSWM_STARTUP_TWO_B, mode=BswM_ModeNotificationPort_OsApp_CORE1_QM_MasterCoreBswMMode.BSWM_STARTUP_TWO_B
        MSE_MasterCoreBswMMode_BSWM_WAKEUP_TWO: starts-on-event=InternalBehavior_1/SE_MasterCoreBswMMode_BSWM_WAKEUP_TWO, mode=BswM_ModeNotificationPort_OsApp_CORE1_QM_MasterCoreBswMMode.BSWM_WAKEUP_TWO
        MSE_MasterCoreAppMode_APP_CONFIG: starts-on-event=InternalBehavior_1/SE_MasterCoreAppMode_APP_CONFIG, mode=BswM_ModeNotificationPort_OsApp_CORE1_QM_MasterCoreAppMode.APP_CONFIG
        MSE_MasterCoreAppMode_APP_OFF: starts-on-event=InternalBehavior_1/SE_MasterCoreAppMode_APP_OFF, mode=BswM_ModeNotificationPort_OsApp_CORE1_QM_MasterCoreAppMode.APP_OFF
        MSE_MasterCoreAppMode_APP_ON: starts-on-event=InternalBehavior_1/SE_MasterCoreAppMode_APP_ON, mode=BswM_ModeNotificationPort_OsApp_CORE1_QM_MasterCoreAppMode.APP_ON
        MSE_MasterCoreAppMode_APP_SYNC_INIT: starts-on-event=InternalBehavior_1/SE_MasterCoreAppMode_APP_SYNC_INIT, mode=BswM_ModeNotificationPort_OsApp_CORE1_QM_MasterCoreAppMode.APP_SYNC_INIT
        MSE_MasterCoreAppMode_APP_WAKEUP: starts-on-event=InternalBehavior_1/SE_MasterCoreAppMode_APP_WAKEUP, mode=BswM_ModeNotificationPort_OsApp_CORE1_QM_MasterCoreAppMode.APP_WAKEUP
        MSE_SlaveCoreBswMMode_BSWM_GO_OFF_ONE_A: starts-on-event=InternalBehavior_1/SE_SlaveCoreBswMMode_BSWM_GO_OFF_ONE_A, mode=BswM_ModeNotificationPort_OsApp_CORE1_QM_SlaveCoreBswMMode.BSWM_GO_OFF_ONE_A
        MSE_SlaveCoreBswMMode_BSWM_GO_SLEEP_ONE: starts-on-event=InternalBehavior_1/SE_SlaveCoreBswMMode_BSWM_GO_SLEEP_ONE, mode=BswM_ModeNotificationPort_OsApp_CORE1_QM_SlaveCoreBswMMode.BSWM_GO_SLEEP_ONE
        MSE_SlaveCoreBswMMode_BSWM_PRP_SHUTDOWN: starts-on-event=InternalBehavior_1/SE_SlaveCoreBswMMode_BSWM_PRP_SHUTDOWN, mode=BswM_ModeNotificationPort_OsApp_CORE1_QM_SlaveCoreBswMMode.BSWM_PRP_SHUTDOWN
        MSE_SlaveCoreBswMMode_BSWM_RUN_TWO: starts-on-event=InternalBehavior_1/SE_SlaveCoreBswMMode_BSWM_RUN_TWO, mode=BswM_ModeNotificationPort_OsApp_CORE1_QM_SlaveCoreBswMMode.BSWM_RUN_TWO
        MSE_SlaveCoreBswMMode_BSWM_STARTUP_TWO_A: starts-on-event=InternalBehavior_1/SE_SlaveCoreBswMMode_BSWM_STARTUP_TWO_A, mode=BswM_ModeNotificationPort_OsApp_CORE1_QM_SlaveCoreBswMMode.BSWM_STARTUP_TWO_A
        MSE_SlaveCoreBswMMode_BSWM_STARTUP_TWO_B: starts-on-event=InternalBehavior_1/SE_SlaveCoreBswMMode_BSWM_STARTUP_TWO_B, mode=BswM_ModeNotificationPort_OsApp_CORE1_QM_SlaveCoreBswMMode.BSWM_STARTUP_TWO_B
        MSE_SlaveCoreBswMMode_BSWM_WAKEUP_TWO: starts-on-event=InternalBehavior_1/SE_SlaveCoreBswMMode_BSWM_WAKEUP_TWO, mode=BswM_ModeNotificationPort_OsApp_CORE1_QM_SlaveCoreBswMMode.BSWM_WAKEUP_TWO
        MSE_SlaveCoreAppMode_APP_CONFIG: starts-on-event=InternalBehavior_1/SE_SlaveCoreAppMode_APP_CONFIG, mode=BswM_ModeNotificationPort_OsApp_CORE1_QM_SlaveCoreAppMode.APP_CONFIG
        MSE_SlaveCoreAppMode_APP_OFF: starts-on-event=InternalBehavior_1/SE_SlaveCoreAppMode_APP_OFF, mode=BswM_ModeNotificationPort_OsApp_CORE1_QM_SlaveCoreAppMode.APP_OFF
        MSE_SlaveCoreAppMode_APP_ON: starts-on-event=InternalBehavior_1/SE_SlaveCoreAppMode_APP_ON, mode=BswM_ModeNotificationPort_OsApp_CORE1_QM_SlaveCoreAppMode.APP_ON
        MSE_SlaveCoreAppMode_APP_SYNC_INIT: starts-on-event=InternalBehavior_1/SE_SlaveCoreAppMode_APP_SYNC_INIT, mode=BswM_ModeNotificationPort_OsApp_CORE1_QM_SlaveCoreAppMode.APP_SYNC_INIT
        MSE_SlaveCoreAppMode_APP_WAKEUP: starts-on-event=InternalBehavior_1/SE_SlaveCoreAppMode_APP_WAKEUP, mode=BswM_ModeNotificationPort_OsApp_CORE1_QM_SlaveCoreAppMode.APP_WAKEUP
      bsw timing event TimingEvent_MainFunction: starts-on-event=InternalBehavior_1/BswM_MainFunction, period=0.01
    bsw internal behavior GenericInternalBehavior: data-type-mapping=[ApplicationModeMapping, BswMModeMapping]
      bsw schedulable entity BswM_MainFunction: implemented-entry=BswM_MainFunction
package /AUTOSAR_BswM/BswModuleEntrys
  26 x bsw module entry, all with is-reentrant=false, sw-service-impl-policy=STANDARD:
    BswM_MainFunction: service-id=3, is-synchronous=true, call-type=SCHEDULED, execution-context=TASK
    BswM_Init: service-id=0, is-synchronous=true, call-type=REGULAR, execution-context=UNSPECIFIED
    BswM_MRPFunc_MasterCoreAppMode_APP_SYNC_INIT: service-id=0, is-synchronous=false, call-type=SCHEDULED, execution-context=TASK
    BswM_MRPFunc_SlaveCoreBswMMode_BSWM_GO_SLEEP_ONE: service-id=0, is-synchronous=false, call-type=SCHEDULED, execution-context=TASK
    BswM_MRPFunc_SlaveCoreBswMMode_BSWM_STARTUP_TWO_A: service-id=0, is-synchronous=false, call-type=SCHEDULED, execution-context=TASK
    BswM_MRPFunc_MasterCoreBswMMode_BSWM_STARTUP_TWO_A: service-id=0, is-synchronous=false, call-type=SCHEDULED, execution-context=TASK
    BswM_MRPFunc_MasterCoreBswMMode_BSWM_PRP_SHUTDOWN: service-id=0, is-synchronous=false, call-type=SCHEDULED, execution-context=TASK
    BswM_MRPFunc_MasterCoreBswMMode_BSWM_STARTUP_TWO_B: service-id=0, is-synchronous=false, call-type=SCHEDULED, execution-context=TASK
    BswM_MRPFunc_SlaveCoreBswMMode_BSWM_RUN_TWO: service-id=0, is-synchronous=false, call-type=SCHEDULED, execution-context=TASK
    BswM_MRPFunc_SlaveCoreBswMMode_BSWM_WAKEUP_TWO: service-id=0, is-synchronous=false, call-type=SCHEDULED, execution-context=TASK
    BswM_MRPFunc_SlaveCoreBswMMode_BSWM_STARTUP_TWO_B: service-id=0, is-synchronous=false, call-type=SCHEDULED, execution-context=TASK
    BswM_MRPFunc_SlaveCoreAppMode_APP_WAKEUP: service-id=0, is-synchronous=false, call-type=SCHEDULED, execution-context=TASK
    BswM_MRPFunc_MasterCoreAppMode_APP_ON: service-id=0, is-synchronous=false, call-type=SCHEDULED, execution-context=TASK
    BswM_MRPFunc_SlaveCoreBswMMode_BSWM_PRP_SHUTDOWN: service-id=0, is-synchronous=false, call-type=SCHEDULED, execution-context=TASK
    BswM_MRPFunc_SlaveCoreBswMMode_BSWM_GO_OFF_ONE_A: service-id=0, is-synchronous=false, call-type=SCHEDULED, execution-context=TASK
    BswM_MRPFunc_SlaveCoreAppMode_APP_SYNC_INIT: service-id=0, is-synchronous=false, call-type=SCHEDULED, execution-context=TASK
    BswM_MRPFunc_MasterCoreBswMMode_BSWM_GO_OFF_ONE_A: service-id=0, is-synchronous=false, call-type=SCHEDULED, execution-context=TASK
    BswM_MRPFunc_SlaveCoreAppMode_APP_OFF: service-id=0, is-synchronous=false, call-type=SCHEDULED, execution-context=TASK
    BswM_MRPFunc_MasterCoreBswMMode_BSWM_GO_SLEEP_ONE: service-id=0, is-synchronous=false, call-type=SCHEDULED, execution-context=TASK
    BswM_MRPFunc_SlaveCoreAppMode_APP_ON: service-id=0, is-synchronous=false, call-type=SCHEDULED, execution-context=TASK
    BswM_MRPFunc_MasterCoreAppMode_APP_CONFIG: service-id=0, is-synchronous=false, call-type=SCHEDULED, execution-context=TASK
    BswM_MRPFunc_MasterCoreBswMMode_BSWM_WAKEUP_TWO: service-id=0, is-synchronous=false, call-type=SCHEDULED, execution-context=TASK
    BswM_MRPFunc_MasterCoreAppMode_APP_WAKEUP: service-id=0, is-synchronous=false, call-type=SCHEDULED, execution-context=TASK
    BswM_MRPFunc_MasterCoreAppMode_APP_OFF: service-id=0, is-synchronous=false, call-type=SCHEDULED, execution-context=TASK
    BswM_MRPFunc_SlaveCoreAppMode_APP_CONFIG: service-id=0, is-synchronous=false, call-type=SCHEDULED, execution-context=TASK
    BswM_MRPFunc_MasterCoreBswMMode_BSWM_RUN_TWO: service-id=0, is-synchronous=false, call-type=SCHEDULED, execution-context=TASK
package /AUTOSAR_BswM/SwcBswMappings
  swc bsw mapping SwcBswMapping_0: bsw-behavior=InternalBehavior_0, swc-bsw-runnable-mapping{bsw-entity=InternalBehavior_0/BswM_MainFunction, swc-runnable=RES_MainFunction}, swc-behavior=BswMInternalBehavior
  swc bsw mapping SwcBswMapping_1: bsw-behavior=InternalBehavior_1, swc-bsw-runnable-mapping{bsw-entity=InternalBehavior_1/BswM_MainFunction, swc-runnable=RES_MainFunction}, swc-behavior=BswMInternalBehavior
package /EB_BswM_TxDxM1I13R0/Implementations
  bsw implementation BswImplementation_0: programming-language=C, sw-version=1.13.0, swc-bsw-mapping=SwcBswMapping_0, vendor-id=1, ar-release-version=4.0.3, behavior=InternalBehavior_0, vendor-api-infix=OsApp_CORE0_QM, vendor-specific-module-def=BswM
    code-descriptors:
      code Files
        artifact-descriptors:
          short-label=Autosar::include::BswM.h, category=SWHDR
          short-label=Autosar::include::BswM_CanSM.h, category=SWHDR
          short-label=Autosar::include::BswM_ComM.h, category=SWHDR
          short-label=Autosar::include::BswM_DCM.h, category=SWHDR
          short-label=Autosar::include::BswM_EcuM.h, category=SWHDR
          short-label=Autosar::include::BswM_EthSM.h, category=SWHDR
          short-label=Autosar::include::BswM_FrSM.h, category=SWHDR
          short-label=Autosar::include::BswM_Int.h, category=SWHDR
          short-label=Autosar::include::BswM_LinTp.h, category=SWHDR
          short-label=Autosar::include::BswM_LinSM.h, category=SWHDR
          short-label=Autosar::include::BswM_NvM.h, category=SWHDR
          short-label=Autosar::include::BswM_Sd.h, category=SWHDR
          short-label=Autosar::include::BswM_WdgM.h, category=SWHDR
          short-label=Autosar::include::BswM_Types.h, category=SWHDR
          short-label=make::BswM_defs.mak, category=SWMAKE
          short-label=make::BswM_rules.mak, category=SWMAKE
    resource consumption ResourceConsumption
      8 x memory section:
        CONFIG_DATA_UNSPECIFIED: alignment=UNSPECIFIED, sw-addrmethod=CONFIG_DATA
        VAR_INIT_UNSPECIFIED: alignment=UNSPECIFIED, sw-addrmethod=VAR_INIT
        VAR_NO_INIT_UNSPECIFIED: alignment=UNSPECIFIED, sw-addrmethod=VAR_NOINIT
        CONST_UNSPECIFIED: alignment=UNSPECIFIED, sw-addrmethod=CONST
        INTERNAL_VAR_POWER_ON_INIT_UNSPECIFIED: alignment=UNSPECIFIED, sw-addrmethod=VAR_POWER_ON_INIT
        CODE: sw-addrmethod=CODE
        VAR_NO_INIT_8: alignment=8, sw-addrmethod=VAR_NOINIT
        VAR_POWER_ON_INIT_32: alignment=32, sw-addrmethod=VAR_POWER_ON_INIT
  bsw implementation BswImplementation_1: programming-language=C, sw-version=1.13.0, swc-bsw-mapping=SwcBswMapping_1, vendor-id=1, ar-release-version=4.0.3, behavior=InternalBehavior_1, vendor-api-infix=OsApp_CORE1_QM, vendor-specific-module-def=BswM
    code-descriptors:
      code Files
        artifact-descriptors:
          short-label=Autosar::include::BswM.h, category=SWHDR
          short-label=Autosar::include::BswM_CanSM.h, category=SWHDR
          short-label=Autosar::include::BswM_ComM.h, category=SWHDR
          short-label=Autosar::include::BswM_DCM.h, category=SWHDR
          short-label=Autosar::include::BswM_EcuM.h, category=SWHDR
          short-label=Autosar::include::BswM_EthSM.h, category=SWHDR
          short-label=Autosar::include::BswM_FrSM.h, category=SWHDR
          short-label=Autosar::include::BswM_Int.h, category=SWHDR
          short-label=Autosar::include::BswM_LinTp.h, category=SWHDR
          short-label=Autosar::include::BswM_LinSM.h, category=SWHDR
          short-label=Autosar::include::BswM_NvM.h, category=SWHDR
          short-label=Autosar::include::BswM_Sd.h, category=SWHDR
          short-label=Autosar::include::BswM_WdgM.h, category=SWHDR
          short-label=Autosar::include::BswM_Types.h, category=SWHDR
          short-label=make::BswM_defs.mak, category=SWMAKE
          short-label=make::BswM_rules.mak, category=SWMAKE
    resource consumption ResourceConsumption
      8 x memory section:
        CONFIG_DATA_UNSPECIFIED: alignment=UNSPECIFIED, sw-addrmethod=CONFIG_DATA
        VAR_INIT_UNSPECIFIED: alignment=UNSPECIFIED, sw-addrmethod=VAR_INIT
        VAR_NO_INIT_UNSPECIFIED: alignment=UNSPECIFIED, sw-addrmethod=VAR_NOINIT
        CONST_UNSPECIFIED: alignment=UNSPECIFIED, sw-addrmethod=CONST
        INTERNAL_VAR_POWER_ON_INIT_UNSPECIFIED: alignment=UNSPECIFIED, sw-addrmethod=VAR_POWER_ON_INIT
        CODE: sw-addrmethod=CODE
        VAR_NO_INIT_8: alignment=8, sw-addrmethod=VAR_NOINIT
        VAR_POWER_ON_INIT_32: alignment=32, sw-addrmethod=VAR_POWER_ON_INIT
  bsw implementation GenericBswImplementation: programming-language=C, sw-version=1.13.0, vendor-id=1, ar-release-version=4.0.3, behavior=GenericInternalBehavior, vendor-specific-module-def=BswM
    code-descriptors:
      code Files
        artifact-descriptors:
          short-label=Autosar::include::BswM.h, category=SWHDR
          short-label=Autosar::include::BswM_CanSM.h, category=SWHDR
          short-label=Autosar::include::BswM_ComM.h, category=SWHDR
          short-label=Autosar::include::BswM_DCM.h, category=SWHDR
          short-label=Autosar::include::BswM_EcuM.h, category=SWHDR
          short-label=Autosar::include::BswM_EthSM.h, category=SWHDR
          short-label=Autosar::include::BswM_FrSM.h, category=SWHDR
          short-label=Autosar::include::BswM_Int.h, category=SWHDR
          short-label=Autosar::include::BswM_LinTp.h, category=SWHDR
          short-label=Autosar::include::BswM_LinSM.h, category=SWHDR
          short-label=Autosar::include::BswM_NvM.h, category=SWHDR
          short-label=Autosar::include::BswM_Sd.h, category=SWHDR
          short-label=Autosar::include::BswM_WdgM.h, category=SWHDR
          short-label=Autosar::include::BswM_Types.h, category=SWHDR
          short-label=make::BswM_defs.mak, category=SWMAKE
          short-label=make::BswM_rules.mak, category=SWMAKE
    resource consumption ResourceConsumption
      8 x memory section:
        CONFIG_DATA_UNSPECIFIED: alignment=UNSPECIFIED, sw-addrmethod=CONFIG_DATA
        VAR_INIT_UNSPECIFIED: alignment=UNSPECIFIED, sw-addrmethod=VAR_INIT
        VAR_NO_INIT_UNSPECIFIED: alignment=UNSPECIFIED, sw-addrmethod=VAR_NOINIT
        CONST_UNSPECIFIED: alignment=UNSPECIFIED, sw-addrmethod=CONST
        INTERNAL_VAR_POWER_ON_INIT_UNSPECIFIED: alignment=UNSPECIFIED, sw-addrmethod=VAR_POWER_ON_INIT
        CODE: sw-addrmethod=CODE
        VAR_NO_INIT_8: alignment=8, sw-addrmethod=VAR_NOINIT
        VAR_POWER_ON_INIT_32: alignment=32, sw-addrmethod=VAR_POWER_ON_INIT
