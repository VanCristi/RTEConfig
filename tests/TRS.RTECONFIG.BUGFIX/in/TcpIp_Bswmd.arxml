AUTOSAR XML (schema 4-0-3)
package /AUTOSAR_TcpIp/BswModuleDescriptions
  bsw module description TcpIp: module-id=170
    provided-entrys:
      TcpIp_MainFunction
      TcpIp_RequestComMode
      TcpIp_Bind
      TcpIp_IpV6_rxIndicationIp
      TcpIp_IpV4_rxIndicationIp
      TcpIp_UdpTransmit
    bsw internal behavior InternalBehavior_0
      6 x exclusive area:
        SCHM_TCPIP_EXCLUSIVE_AREA_{0..5}
      bsw schedulable entity TcpIp_MainFunction: can-enter-exclusive-area=[SCHM_TCPIP_EXCLUSIVE_AREA_0, SCHM_TCPIP_EXCLUSIVE_AREA_1, SCHM_TCPIP_EXCLUSIVE_AREA_3], implemented-entry=TcpIp_MainFunction
      5 x bsw called entity:
        TcpIp_RequestComMode: can-enter-exclusive-area=SCHM_TCPIP_EXCLUSIVE_AREA_1, implemented-entry=TcpIp_RequestComMode
        TcpIp_Bind: can-enter-exclusive-area=SCHM_TCPIP_EXCLUSIVE_AREA_2, implemented-entry=TcpIp_Bind
        TcpIp_IpV6_rxIndicationIp: can-enter-exclusive-area=SCHM_TCPIP_EXCLUSIVE_AREA_5, implemented-entry=TcpIp_IpV6_rxIndicationIp
        TcpIp_IpV4_rxIndicationIp: can-enter-exclusive-area=SCHM_TCPIP_EXCLUSIVE_AREA_5, implemented-entry=TcpIp_IpV4_rxIndicationIp
        TcpIp_UdpTransmit: can-enter-exclusive-area=SCHM_TCPIP_EXCLUSIVE_AREA_4, implemented-entry=TcpIp_UdpTransmit
      bsw timing event TimingEvent_MainFunction: starts-on-event=TcpIp_MainFunction, period=0.1
package /AUTOSAR_TcpIp/BswModuleEntrys
  6 x bsw module entry, all with sw-service-impl-policy=STANDARD:
    TcpIp_MainFunction: service-id=21, is-reentrant=false, is-synchronous=true, call-type=SCHEDULED, execution-context=TASK
    TcpIp_RequestComMode: service-id=9, is-reentrant=false, is-synchronous=false, call-type=REGULAR, execution-context=UNSPECIFIED
    TcpIp_Bind: service-id=5, is-reentrant=false, is-synchronous=false, call-type=REGULAR, execution-context=UNSPECIFIED
    TcpIp_IpV6_rxIndicationIp: service-id=5, is-reentrant=false, is-synchronous=false, call-type=REGULAR, execution-context=UNSPECIFIED
    TcpIp_IpV4_rxIndicationIp: service-id=5, is-reentrant=false, is-synchronous=false, call-type=REGULAR, execution-context=UNSPECIFIED
    TcpIp_UdpTransmit: service-id=18, is-reentrant=true, is-synchronous=false, call-type=REGULAR, execution-context=UNSPECIFIED
package /EB_TcpIp_TxDxM3I2R0/Implementations
  bsw implementation BswImplementation_0: programming-language=C, sw-version=3.2.3, vendor-id=1, ar-release-version=4.0.3, behavior=InternalBehavior_0, vendor-specific-module-def=TcpIp
    code-descriptors:
      code Files
        artifact-descriptors:
          short-label=Autosar::include::TcpIp.h, category=SWHDR
          short-label=Autosar::include::TcpIp_Api.h, category=SWHDR
          short-label=Autosar::include::TcpIp_Cbk.h, category=SWHDR
          short-label=Autosar::include::TcpIp_DhcpV4_Api.h, category=SWHDR
          short-label=Autosar::include::TcpIp_DhcpV6_Api.h, category=SWHDR
          short-label=Autosar::include::TcpIp_IpAddrM_Api.h, category=SWHDR
          short-label=Autosar::include::TcpIp_IpV4_Api.h, category=SWHDR
          short-label=Autosar::include::TcpIp_Ip_Api.h, category=SWHDR
          short-label=Autosar::include::TcpIp_Socket_Api.h, category=SWHDR
          short-label=Autosar::include::TcpIp_Tcp_Api.h, category=SWHDR
          short-label=Autosar::include::TcpIp_Udp_Api.h, category=SWHDR
          short-label=Autosar::include::TcpIp_Version.h, category=SWHDR
          short-label=Autosar::src::TcpIp_Dhcp.c, category=SWSRC
          short-label=Autosar::src::TcpIp_DhcpV4.c, category=SWSRC
          short-label=Autosar::src::TcpIp_DhcpV6.c, category=SWSRC
          short-label=Autosar::src::TcpIp_Ip.c, category=SWSRC
          short-label=Autosar::src::TcpIp_IpAddrM.c, category=SWSRC
          short-label=Autosar::src::TcpIp_IpAddrM_AssignSM.c, category=SWSRC
          short-label=Autosar::src::TcpIp_IpAddrM_CtrlSM.c, category=SWSRC
          short-label=Autosar::src::TcpIp_IpAddrM_LocalAddrSM.c, category=SWSRC
          short-label=Autosar::src::TcpIp_IpV4.c, category=SWSRC
          short-label=Autosar::src::TcpIp_IpV4_AddrConflDetect.c, category=SWSRC
          short-label=Autosar::src::TcpIp_IpV4_Arp.c, category=SWSRC
          short-label=Autosar::src::TcpIp_IpV4_Icmp.c, category=SWSRC
          short-label=Autosar::src::TcpIp_IpV4_LinkLocal.c, category=SWSRC
          short-label=Autosar::src::TcpIp_IpV4_StaticIp.c, category=SWSRC
          short-label=Autosar::src::TcpIp_IpV6.c, category=SWSRC
          short-label=Autosar::src::TcpIp_IpV6_Icmp.c, category=SWSRC
          short-label=Autosar::src::TcpIp_IpV6_LinkLocal.c, category=SWSRC
          short-label=Autosar::src::TcpIp_IpV6_StaticIp.c, category=SWSRC
          short-label=Autosar::src::TcpIp_Ip_Frag.c, category=SWSRC
          short-label=Autosar::src::TcpIp_Ip_Reass.c, category=SWSRC
          short-label=Autosar::src::TcpIp_Memory.c, category=SWSRC
          short-label=Autosar::src::TcpIp_Merged.c, category=SWSRC
          short-label=Autosar::src::TcpIp_Ndp.c, category=SWSRC
          short-label=Autosar::src::TcpIp_Socket.c, category=SWSRC
          short-label=Autosar::src::TcpIp_Socket_TCP.c, category=SWSRC
          short-label=Autosar::src::TcpIp_Socket_UDP.c, category=SWSRC
          short-label=Autosar::src::TcpIp_Tcp.c, category=SWSRC
          short-label=Autosar::src::TcpIp_Tcp_SM.c, category=SWSRC
          short-label=Autosar::src::TcpIp_Tcp_rxData.c, category=SWSRC
          short-label=Autosar::src::TcpIp_Tcp_txData.c, category=SWSRC
          short-label=Autosar::src::TcpIp_Udp.c, category=SWSRC
          short-label=Autosar::src::TcpIp.c, category=SWSRC
          short-label=make::TcpIp_defs.mak, category=SWMAKE
          short-label=make::TcpIp_rules.mak, category=SWMAKE
    resource consumption ResourceConsumption
      14 x memory section:
        VAR_NO_INIT_UNSPECIFIED: alignment=UNSPECIFIED, sw-addrmethod=VAR_NOINIT
        CODE: sw-addrmethod=CODE
        VAR_INIT_32: alignment=32, sw-addrmethod=VAR
        CONFIG_DATA_UNSPECIFIED: alignment=UNSPECIFIED, sw-addrmethod=CONFIG_DATA
        CONST_UNSPECIFIED: alignment=UNSPECIFIED, sw-addrmethod=CONST
        VAR_INIT_8: alignment=8, sw-addrmethod=VAR
        VAR_NO_INIT_16: alignment=16, sw-addrmethod=VAR_NOINIT
        CONST_8: alignment=8, sw-addrmethod=CONST
        CONST_16: alignment=16, sw-addrmethod=CONST
        CONST_32: alignment=32, sw-addrmethod=CONST
        VAR_NO_INIT_32: alignment=32, sw-addrmethod=VAR_NOINIT
        VAR_NO_INIT_8: alignment=8, sw-addrmethod=VAR_NOINIT
        VAR_INIT_UNSPECIFIED: alignment=UNSPECIFIED, sw-addrmethod=VAR
        VAR_INIT_16: alignment=16, sw-addrmethod=VAR
