AUTOSAR XML (schema 4-0-3)
package /AUTOSAR_Adc/BswModuleDescriptions
  bsw module description Adc: module-id=123, provided-entrys=Adc_Init
    bsw internal behavior InternalBehavior_0
      exclusive area KernelData
      bsw called entity Adc_Init: can-enter-exclusive-area=KernelData, implemented-entry=Adc_Init
package /AUTOSAR_Adc/BswModuleEntrys
  bsw module entry Adc_Init: service-id=0, is-reentrant=false, is-synchronous=true, call-type=REGULAR, execution-context=UNSPECIFIED, sw-service-impl-policy=STANDARD
package /Adc_TS_T16D26M2I1R0/Implementations
  bsw implementation BswImplementation_0: programming-language=C, sw-version=2.1.0, vendor-id=17, ar-release-version=4.2.2, behavior=InternalBehavior_0, vendor-specific-module-def=Adc
    code-descriptors:
      code Files: artifact-descriptors=[{short-label=make::Adc_defs.mak, category=SWMAKE}, {short-label=make::Adc_rules.mak, category=SWMAKE}]
    resource consumption ResourceConsumption
      6 x memory section:
        ADC_CODE: sw-addrmethod=CODE, symbol=CODE
        ADC_CODE_QM_GLOBAL: sw-addrmethod=CODE, symbol=CODE_QM_GLOBAL
        ADC_CONFIG_DATA_QM_UNSPECIFIED: alignment=UNSPECIFIED, sw-addrmethod=DATA, symbol=CONFIG_DATA_QM_UNSPECIFIED
        ADC_CONST_QM_8: alignment=8, sw-addrmethod=CONST, symbol=CONST_QM_8
        ADC_VAR_CLEARED_QM_LOCAL_32: alignment=32, sw-addrmethod=VAR, symbol=VAR_CLEARED_QM_LOCAL_32
        ADC_VAR_CLEARED_QM_LOCAL_UNSPECIFIED: alignment=UNSPECIFIED, sw-addrmethod=VAR, symbol=VAR_CLEARED_QM_LOCAL_UNSPECIFIED
