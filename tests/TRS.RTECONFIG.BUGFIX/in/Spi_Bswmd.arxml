AUTOSAR XML (schema 4-0-3)
package /AUTOSAR_Spi/BswModuleDescriptions
  bsw module description Spi: module-id=83, provided-entrys=Spi_Init
    bsw internal behavior InternalBehavior_0
      9 x exclusive area:
        Cancel_Seq
        ChannelLock
        Queue_Update_QSPI{0..5}
        SyncLock
      bsw called entity Spi_Init: can-enter-exclusive-area=[Cancel_Seq, ChannelLock, Queue_Update_QSPI0, Queue_Update_QSPI1, Queue_Update_QSPI2, Queue_Update_QSPI3, Queue_Update_QSPI4, Queue_Update_QSPI5, SyncLock], implemented-entry=Spi_Init
package /AUTOSAR_Spi/BswModuleEntrys
  bsw module entry Spi_Init: service-id=83, is-reentrant=false, is-synchronous=true, call-type=REGULAR, execution-context=UNSPECIFIED, sw-service-impl-policy=STANDARD
  bsw module entry Spi_MainFunction_Handling: service-id=16, is-reentrant=false, is-synchronous=true, call-type=SCHEDULED, execution-context=TASK, sw-service-impl-policy=STANDARD
package /Spi_TS_T16D26M3I0R0/Implementations
  bsw implementation BswImplementation_0: programming-language=C, sw-version=3.0.0, vendor-id=17, ar-release-version=4.2.2, behavior=InternalBehavior_0, vendor-specific-module-def=Spi
    code-descriptors:
      code Files: artifact-descriptors=[{short-label=make::Spi_defs.mak, category=SWMAKE}, {short-label=make::Spi_rules.mak, category=SWMAKE}]
    resource consumption ResourceConsumption
      29 x memory section:
        SPI_CODE: sw-addrmethod=CODE, symbol=CODE
        SPI_CODE_QM_GLOBAL: sw-addrmethod=CODE, symbol=CODE_QM_GLOBAL
        SPI_CONFIG_DATA_QM_UNSPECIFIED: alignment=UNSPECIFIED, sw-addrmethod=CONFIG_DATA, symbol=CONFIG_DATA_QM_UNSPECIFIED
        SPI_VAR_CLEARED_QM_LOCAL_32: alignment=32, sw-addrmethod=VAR, symbol=VAR_CLEARED_QM_LOCAL_32
        SPI_VAR_CLEARED_QM_LOCAL_8: alignment=8, sw-addrmethod=VAR, symbol=VAR_CLEARED_QM_LOCAL_8
        SPI_VAR_CLEARED_QM_LOCAL_UNSPECIFIED: alignment=UNSPECIFIED, sw-addrmethod=VAR, symbol=VAR_CLEARED_QM_LOCAL_UNSPECIFIED
        SPI_VAR_CLEARED_QM_QSPI0_16: alignment=16, sw-addrmethod=VAR, symbol=VAR_CLEARED_QM_QSPI0_16
        SPI_VAR_CLEARED_QM_QSPI0_256: sw-addrmethod=VAR, symbol=VAR_CLEARED_QM_QSPI0_256
        SPI_VAR_CLEARED_QM_QSPI0_32: alignment=32, sw-addrmethod=VAR, symbol=VAR_CLEARED_QM_QSPI0_32
        SPI_VAR_CLEARED_QM_QSPI0_UNSPECIFIED: alignment=UNSPECIFIED, sw-addrmethod=VAR, symbol=VAR_CLEARED_QM_QSPI0_UNSPECIFIED
        SPI_VAR_CLEARED_QM_QSPI1_256: sw-addrmethod=VAR, symbol=VAR_CLEARED_QM_QSPI1_256
        SPI_VAR_CLEARED_QM_QSPI1_32: alignment=32, sw-addrmethod=VAR, symbol=VAR_CLEARED_QM_QSPI1_32
        SPI_VAR_CLEARED_QM_QSPI1_UNSPECIFIED: alignment=UNSPECIFIED, sw-addrmethod=VAR, symbol=VAR_CLEARED_QM_QSPI1_UNSPECIFIED
        SPI_VAR_CLEARED_QM_QSPI2_16: alignment=16, sw-addrmethod=VAR, symbol=VAR_CLEARED_QM_QSPI2_16
        SPI_VAR_CLEARED_QM_QSPI2_256: sw-addrmethod=VAR, symbol=VAR_CLEARED_QM_QSPI2_256
        SPI_VAR_CLEARED_QM_QSPI2_32: alignment=32, sw-addrmethod=VAR, symbol=VAR_CLEARED_QM_QSPI2_32
        SPI_VAR_CLEARED_QM_QSPI2_UNSPECIFIED: alignment=UNSPECIFIED, sw-addrmethod=VAR, symbol=VAR_CLEARED_QM_QSPI2_UNSPECIFIED
        SPI_VAR_CLEARED_QM_QSPI3_16: alignment=16, sw-addrmethod=VAR, symbol=VAR_CLEARED_QM_QSPI3_16
        SPI_VAR_CLEARED_QM_QSPI3_256: sw-addrmethod=VAR, symbol=VAR_CLEARED_QM_QSPI3_256
        SPI_VAR_CLEARED_QM_QSPI3_32: alignment=32, sw-addrmethod=VAR, symbol=VAR_CLEARED_QM_QSPI3_32
        SPI_VAR_CLEARED_QM_QSPI3_UNSPECIFIED: alignment=UNSPECIFIED, sw-addrmethod=VAR, symbol=VAR_CLEARED_QM_QSPI3_UNSPECIFIED
        SPI_VAR_CLEARED_QM_QSPI4_16: alignment=16, sw-addrmethod=VAR, symbol=VAR_CLEARED_QM_QSPI4_16
        SPI_VAR_CLEARED_QM_QSPI4_256: sw-addrmethod=VAR, symbol=VAR_CLEARED_QM_QSPI4_256
        SPI_VAR_CLEARED_QM_QSPI4_32: alignment=32, sw-addrmethod=VAR, symbol=VAR_CLEARED_QM_QSPI4_32
        SPI_VAR_CLEARED_QM_QSPI4_UNSPECIFIED: alignment=UNSPECIFIED, sw-addrmethod=VAR, symbol=VAR_CLEARED_QM_QSPI4_UNSPECIFIED
        SPI_VAR_CLEARED_QM_QSPI5_16: alignment=16, sw-addrmethod=VAR, symbol=VAR_CLEARED_QM_QSPI5_16
        SPI_VAR_CLEARED_QM_QSPI5_256: sw-addrmethod=VAR, symbol=VAR_CLEARED_QM_QSPI5_256
        SPI_VAR_CLEARED_QM_QSPI5_32: alignment=32, sw-addrmethod=VAR, symbol=VAR_CLEARED_QM_QSPI5_32
        SPI_VAR_CLEARED_QM_QSPI5_UNSPECIFIED: alignment=UNSPECIFIED, sw-addrmethod=VAR, symbol=VAR_CLEARED_QM_QSPI5_UNSPECIFIED
