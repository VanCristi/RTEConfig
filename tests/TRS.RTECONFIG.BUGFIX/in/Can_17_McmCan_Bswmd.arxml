AUTOSAR XML (schema 4-0-3)
package /AUTOSAR_Can/BswModuleDescriptions
  bsw module description Can_17_McmCan: module-id=80, provided-entrys=[Can_17_McmCan_Init, Can_17_McmCan_MainFunction_Mode]
    bsw internal behavior InternalBehavior_0
      exclusive area CanDisInt
      exclusive area CanEnInt
      exclusive area CanWrMO
      bsw called entity Can_17_McmCan_Init: can-enter-exclusive-area=[CanDisInt, CanEnInt, CanWrMO], implemented-entry=Can_17_McmCan_Init
      bsw schedulable entity Can_17_McmCan_MainFunction_Mode: implemented-entry=Can_17_McmCan_MainFunction_Mode
      bsw timing event TimingEvent_MainFunction_Mode: starts-on-event=Can_17_McmCan_MainFunction_Mode, period=0.001
package /AUTOSAR_Can/BswModuleEntrys
  bsw module entry Can_17_McmCan_Init: service-id=0, is-reentrant=false, is-synchronous=true, call-type=REGULAR, execution-context=UNSPECIFIED, sw-service-impl-policy=STANDARD
  bsw module entry Can_17_McmCan_MainFunction_Mode: service-id=12, is-reentrant=false, is-synchronous=true, call-type=SCHEDULED, execution-context=TASK, sw-service-impl-policy=STANDARD
package /Can_TS_T16D26M2I0R0/Implementations
  bsw implementation BswImplementation_0: programming-language=C, sw-version=2.0.0, vendor-id=17, ar-release-version=4.2.2, behavior=InternalBehavior_0, vendor-specific-module-def=Can
    code-descriptors:
      code Files: artifact-descriptors=[{short-label=make::Can_defs.mak, category=SWMAKE}, {short-label=make::Can_rules.mak, category=SWMAKE}]
    resource consumption ResourceConsumption
      6 x memory section, all with prefix=CAN_17_MCMCAN:
        CAN_17_MCMCAN_CODE: sw-addrmethod=CODE, symbol=CODE
        CAN_17_MCMCAN_CODE_QM_GLOBAL: sw-addrmethod=CODE, symbol=CODE_QM_GLOBAL
        CAN_17_MCMCAN_CONFIG_DATA_QM_UNSPECIFIED: alignment=UNSPECIFIED, sw-addrmethod=CONFIG_DATA, symbol=CONFIG_DATA_QM_UNSPECIFIED
        CAN_17_MCMCAN_VAR_CLEARED_QM_GLOBAL_16: alignment=16, sw-addrmethod=VAR, symbol=VAR_CLEARED_QM_GLOBAL_16
        CAN_17_MCMCAN_VAR_CLEARED_QM_GLOBAL_32: alignment=32, sw-addrmethod=VAR, symbol=VAR_CLEARED_QM_GLOBAL_32
        CAN_17_MCMCAN_VAR_CLEARED_QM_GLOBAL_8: alignment=8, sw-addrmethod=VAR, symbol=VAR_CLEARED_QM_GLOBAL_8
      section name prefix CAN_17_MCMCAN
