AUTOSAR XML (schema 4-0-3)
package /AUTOSAR_MemIf/BswModuleDescriptions
  bsw module description MemIf: module-id=22, provided-entrys=MemIf_SetMode
    bsw internal behavior InternalBehavior_0
      bsw called entity MemIf_SetMode: implemented-entry=MemIf_SetMode
package /AUTOSAR_MemIf/BswModuleEntrys
  bsw module entry MemIf_SetMode: service-id=1, is-reentrant=false, is-synchronous=true, call-type=REGULAR, execution-context=TASK, sw-service-impl-policy=STANDARD
    sw service arg Mode: direction=IN, implementation-data-type=MemIf_ModeType
package /AUTOSAR_MemIf/ImplementationDataTypes
  impl type MemIf_ModeType: compu {0=MEMIF_MODE_SLOW, 1=MEMIF_MODE_FAST}, implementation-data-type=uint32, type-emitter=BSW
  impl type MemIf_StatusType: compu {0=MEMIF_UNINIT, 1=MEMIF_IDLE, 2=MEMIF_BUSY, 3=MEMIF_BUSY_INTERNAL}, implementation-data-type=uint32, type-emitter=BSW
  impl type MemIf_JobResultType: compu {0=MEMIF_JOB_OK, 1=MEMIF_JOB_FAILED, 2=MEMIF_JOB_PENDING, 3=MEMIF_JOB_CANCELED, 4=MEMIF_BLOCK_INCONSISTENT, 5=MEMIF_BLOCK_INVALID}, implementation-data-type=uint32, type-emitter=BSW
package /EB_MemIf_TxDxM5I10R0/Implementations
  bsw implementation BswImplementation_0: programming-language=C, sw-version=5.10.0, vendor-id=1, ar-release-version=4.0.3, behavior=InternalBehavior_0, vendor-specific-module-def=MemIf
    code-descriptors:
      code Files
        artifact-descriptors:
          short-label=Autosar::include::MemIf.h, category=SWHDR
          short-label=Autosar::include::MemIf_Trace_Internal.h, category=SWHDR
          short-label=Autosar::include::MemIf_Types.h, category=SWHDR
          short-label=Autosar::include::MemIf_Trace.h, category=SWHDR
          short-label=Autosar::include::MemIf_Version.h, category=SWHDR
          short-label=Autosar::src::MemIf.c, category=SWSRC
          short-label=make::MemIf_defs.mak, category=SWMAKE
          short-label=make::MemIf_rules.mak, category=SWMAKE
    resource consumption ResourceConsumption
      memory section CODE: sw-addrmethod=CODE
      memory section CONST_UNSPECIFIED: alignment=UNSPECIFIED, sw-addrmethod=CONST
