AUTOSAR XML (schema 4-0-3)
package /AUTOSAR_Dcm/BswModuleDescriptions
  bsw module description Dcm: module-id=53, provided-entrys=Dcm_MainFunction
    bsw internal behavior InternalBehavior_0
      exclusive area SCHM_DCM_EXCLUSIVE_AREA_0
      bsw schedulable entity Dcm_MainFunction: can-enter-exclusive-area=SCHM_DCM_EXCLUSIVE_AREA_0, implemented-entry=Dcm_MainFunction
      bsw timing event TimingEvent_MainFunction: starts-on-event=Dcm_MainFunction, period=0.01
package /AUTOSAR_Dcm/BswModuleEntrys
  bsw module entry Dcm_MainFunction: service-id=37, is-reentrant=false, is-synchronous=true, call-type=SCHEDULED, execution-context=TASK, sw-service-impl-policy=STANDARD
package /EB_Dcm_TxDxM4I12R0/Implementations
  bsw implementation BswImplementation_0: programming-language=C, sw-version=4.12.12, vendor-id=1, ar-release-version=4.0.3, behavior=InternalBehavior_0, vendor-specific-module-def=Dcm
    code-descriptors:
      code Files
        artifact-descriptors:
          short-label=Autosar::include::Dcm.h, category=SWHDR
          short-label=Autosar::include::Dcm_Cbk.h, category=SWHDR
          short-label=Autosar::include::Dcm_Dsl_CommunicationServices.h, category=SWHDR
          short-label=Autosar::include::Dcm_Dsl_RoeServices.h, category=SWHDR
          short-label=Autosar::include::Dcm_Dsl_SecurityLevelHandler.h, category=SWHDR
          short-label=Autosar::include::Dcm_Dsl_Supervisor.h, category=SWHDR
          short-label=Autosar::include::Dcm_DspExternal.h, category=SWHDR
          short-label=Autosar::include::Dcm_Dsp_Contexts.h, category=SWHDR
          short-label=Autosar::include::Dcm_Dsp_DataTransferServices.h, category=SWHDR
          short-label=Autosar::include::Dcm_Dsp_DemFacade.h, category=SWHDR
          short-label=Autosar::include::Dcm_Dsp_DidServices.h, category=SWHDR
          short-label=Autosar::include::Dcm_Dsp_MemoryServices.h, category=SWHDR
          short-label=Autosar::include::Dcm_Dsp_MidServices.h, category=SWHDR
          short-label=Autosar::include::Dcm_Dsp_PidServices.h, category=SWHDR
          short-label=Autosar::include::Dcm_Dsp_SvcH_CommunicationControl.h, category=SWHDR
          short-label=Autosar::include::Dcm_Dsp_SvcH_ControlDTCSetting.h, category=SWHDR
          short-label=Autosar::include::Dcm_Dsp_SvcH_DynamicallyDefineDataIdentifier.h, category=SWHDR
          short-label=Autosar::include::Dcm_Dsp_SvcH_InputOutputControlByIdentifier.h, category=SWHDR
          short-label=Autosar::include::Dcm_Dsp_SvcH_LinkControl.h, category=SWHDR
          short-label=Autosar::include::Dcm_Dsp_SvcH_ReadDTCInformation.h, category=SWHDR
          short-label=Autosar::include::Dcm_Dsp_SvcH_ReadDataByIdentifier.h, category=SWHDR
          short-label=Autosar::include::Dcm_Dsp_SvcH_ReadDataByPeriodicIdentifier.h, category=SWHDR
          short-label=Autosar::include::Dcm_Dsp_SvcH_ReadMemoryByAddress.h, category=SWHDR
          short-label=Autosar::include::Dcm_Dsp_SvcH_RequestControlOfOnBoardSysTstComp.h, category=SWHDR
          short-label=Autosar::include::Dcm_Dsp_SvcH_RequestDownload.h, category=SWHDR
          short-label=Autosar::include::Dcm_Dsp_SvcH_RequestOnboardMonitoringTestResults.h, category=SWHDR
          short-label=Autosar::include::Dcm_Dsp_SvcH_RequestTransferExit.h, category=SWHDR
          short-label=Autosar::include::Dcm_Dsp_SvcH_RequestUpload.h, category=SWHDR
          short-label=Autosar::include::Dcm_Dsp_SvcH_RequestVehicleInformation.h, category=SWHDR
          short-label=Autosar::include::Dcm_Dsp_SvcH_ResponseOnEvent.h, category=SWHDR
          short-label=Autosar::include::Dcm_Dsp_SvcH_SecurityAccess.h, category=SWHDR
          short-label=Autosar::include::Dcm_Dsp_SvcH_TransferData.h, category=SWHDR
          short-label=Autosar::include::Dcm_Dsp_SvcH_WriteDataByIdentifier.h, category=SWHDR
          short-label=Autosar::include::Dcm_Dsp_SvcH_WriteMemoryByAddress.h, category=SWHDR
          short-label=Autosar::include::Dcm_Hsm.h, category=SWHDR
          short-label=Autosar::include::Dcm_HsmCfg.h, category=SWHDR
          short-label=Autosar::include::Dcm_HsmDcm.h, category=SWHDR
          short-label=Autosar::include::Dcm_HsmDcmInt.h, category=SWHDR
          short-label=Autosar::include::Dcm_Int.h, category=SWHDR
          short-label=Autosar::include::Dcm_Trace_Internal.h, category=SWHDR
          short-label=Autosar::include::Dcm_Types.h, category=SWHDR
          short-label=Autosar::include::Dcm_Trace.h, category=SWHDR
          short-label=Autosar::include::Dcm_Version.h, category=SWHDR
          short-label=Autosar::src::Dcm_Dsd.c, category=SWSRC
          short-label=Autosar::src::Dcm_Dsl.c, category=SWSRC
          short-label=Autosar::src::Dcm_Dsl_CommunicationServices.c, category=SWSRC
          short-label=Autosar::src::Dcm_Dsl_RoeServices.c, category=SWSRC
          short-label=Autosar::src::Dcm_Dsl_SecurityLevelHandler.c, category=SWSRC
          short-label=Autosar::src::Dcm_Dsl_Supervisor.c, category=SWSRC
          short-label=Autosar::src::Dcm_Dsp.c, category=SWSRC
          short-label=Autosar::src::Dcm_Dsp_Contexts.c, category=SWSRC
          short-label=Autosar::src::Dcm_Dsp_DataTransferServices.c, category=SWSRC
          short-label=Autosar::src::Dcm_Dsp_DemFacade.c, category=SWSRC
          short-label=Autosar::src::Dcm_Dsp_DidServices.c, category=SWSRC
          short-label=Autosar::src::Dcm_Dsp_MemoryServices.c, category=SWSRC
          short-label=Autosar::src::Dcm_Dsp_MidServices.c, category=SWSRC
          short-label=Autosar::src::Dcm_Dsp_PidServices.c, category=SWSRC
          short-label=Autosar::src::Dcm_Dsp_SvcH_CommunicationControl.c, category=SWSRC
          short-label=Autosar::src::Dcm_Dsp_SvcH_ControlDTCSetting.c, category=SWSRC
          short-label=Autosar::src::Dcm_Dsp_SvcH_DynamicallyDefineDataIdentifier.c, category=SWSRC
          short-label=Autosar::src::Dcm_Dsp_SvcH_InputOutputControlByIdentifier.c, category=SWSRC
          short-label=Autosar::src::Dcm_Dsp_SvcH_LinkControl.c, category=SWSRC
          short-label=Autosar::src::Dcm_Dsp_SvcH_ReadDTCInformation.c, category=SWSRC
          short-label=Autosar::src::Dcm_Dsp_SvcH_ReadDataByIdentifier.c, category=SWSRC
          short-label=Autosar::src::Dcm_Dsp_SvcH_ReadDataByPeriodicIdentifier.c, category=SWSRC
          short-label=Autosar::src::Dcm_Dsp_SvcH_ReadMemoryByAddress.c, category=SWSRC
          short-label=Autosar::src::Dcm_Dsp_SvcH_RequestControlOfOnBoardSysTstComp.c, category=SWSRC
          short-label=Autosar::src::Dcm_Dsp_SvcH_RequestDownload.c, category=SWSRC
          short-label=Autosar::src::Dcm_Dsp_SvcH_RequestOnboardMonitoringTestResults.c, category=SWSRC
          short-label=Autosar::src::Dcm_Dsp_SvcH_RequestTransferExit.c, category=SWSRC
          short-label=Autosar::src::Dcm_Dsp_SvcH_RequestUpload.c, category=SWSRC
          short-label=Autosar::src::Dcm_Dsp_SvcH_RequestVehicleInformation.c, category=SWSRC
          short-label=Autosar::src::Dcm_Dsp_SvcH_ResponseOnEvent.c, category=SWSRC
          short-label=Autosar::src::Dcm_Dsp_SvcH_SecurityAccess.c, category=SWSRC
          short-label=Autosar::src::Dcm_Dsp_SvcH_TransferData.c, category=SWSRC
          short-label=Autosar::src::Dcm_Dsp_SvcH_WriteDataByIdentifier.c, category=SWSRC
          short-label=Autosar::src::Dcm_Dsp_SvcH_WriteMemoryByAddress.c, category=SWSRC
          short-label=Autosar::src::Dcm_Hsm.c, category=SWSRC
          short-label=Autosar::src::Dcm_HsmDcmData.c, category=SWSRC
          short-label=Autosar::src::Dcm_HsmDcmFnct.c, category=SWSRC
          short-label=Autosar::src::Dcm.c, category=SWSRC
          short-label=make::Dcm_defs.mak, category=SWMAKE
          short-label=make::Dcm_rules.mak, category=SWMAKE
    resource consumption ResourceConsumption
      15 x memory section:
        CONST_UNSPECIFIED: alignment=UNSPECIFIED, sw-addrmethod=CONST
        CONST_32: alignment=32, sw-addrmethod=CONST
        CONST_16: alignment=16, sw-addrmethod=CONST
        VAR_NO_INIT_8: alignment=8, sw-addrmethod=VAR_NOINIT
        CONST_8: alignment=8, sw-addrmethod=CONST
        CODE: sw-addrmethod=CODE
        CALLOUT_CODE: sw-addrmethod=CALLOUT_CODE
        VAR_INIT_UNSPECIFIED: alignment=UNSPECIFIED, sw-addrmethod=VAR
        VAR_NO_INIT_UNSPECIFIED: alignment=UNSPECIFIED, sw-addrmethod=VAR_NOINIT
        VAR_POWER_ON_CLEARED_UNSPECIFIED: alignment=UNSPECIFIED, sw-addrmethod=VAR
        VAR_INIT_8: alignment=8, sw-addrmethod=VAR
        VAR_INIT_16: alignment=16, sw-addrmethod=VAR
        VAR_NO_INIT_16: alignment=16, sw-addrmethod=VAR_NOINIT
        VAR_NO_INIT_32: alignment=32, sw-addrmethod=VAR_NOINIT
        VAR_INIT_32: alignment=32, sw-addrmethod=VAR
