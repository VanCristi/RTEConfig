AUTOSAR XML (schema 4-0-3)
package /AUTOSAR_Lin/BswModuleDescriptions
  bsw module description Lin_17_AscLin: module-id=82, provided-entrys=Lin_17_AscLin_Init
    bsw internal behavior InternalBehavior_0
      bsw called entity Lin_17_AscLin_Init: implemented-entry=Lin_17_AscLin_Init
package /AUTOSAR_Lin/BswModuleEntrys
  bsw module entry Lin_17_AscLin_Init: service-id=82, is-reentrant=false, is-synchronous=true, call-type=REGULAR, execution-context=UNSPECIFIED, sw-service-impl-policy=STANDARD
package /Lin_TS_T16D26M1I0R0/Implementations
  bsw implementation BswImplementation_0: programming-language=C, sw-version=1.0.0, vendor-id=17, ar-release-version=4.2.2, behavior=InternalBehavior_0, vendor-specific-module-def=Lin
    code-descriptors:
      code Files: artifact-descriptors=[{short-label=make::Lin_defs.mak, category=SWMAKE}, {short-label=make::Lin_rules.mak, category=SWMAKE}]
    resource consumption ResourceConsumption
      4 x memory section, all with prefix=LIN_17_ASCLIN:
        LIN_17_ASCLIN_CODE_QM_GLOBAL: sw-addrmethod=CODE, symbol=CODE_QM_GLOBAL
        LIN_17_ASCLIN_CONFIG_DATA_QM_UNSPECIFIED: alignment=UNSPECIFIED, sw-addrmethod=CONFIG_DATA, symbol=CONFIG_DATA_QM_UNSPECIFIED
        LIN_17_ASCLIN_VAR_CLEARED_QM_32: alignment=32, sw-addrmethod=VAR, symbol=VAR_CLEARED_QM_32
        LIN_17_ASCLIN_VAR_CLEARED_QM_8: alignment=8, sw-addrmethod=VAR, symbol=VAR_CLEARED_QM_8
      section name prefix LIN_17_ASCLIN
