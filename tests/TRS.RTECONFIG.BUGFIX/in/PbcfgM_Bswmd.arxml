AUTOSAR XML (schema 4-0-3)
package /AUTOSAR_PbcfgM/BswModuleDescriptions
  bsw module description PbcfgM: module-id=32769, provided-entrys=PbcfgM_Init
    bsw internal behavior InternalBehavior_0
      static-memorys:
        data PbcfgM_InitStatus: type=PbcfgM_StatusType
      bsw called entity PbcfgM_Init: implemented-entry=PbcfgM_Init
package /AUTOSAR_PbcfgM/BswModuleEntrys
  bsw module entry PbcfgM_Init: service-id=1, is-reentrant=false, is-synchronous=true, call-type=REGULAR, execution-context=TASK, sw-service-impl-policy=STANDARD
    sw service arg PbcfgM_ConfigPtr: direction=IN, implementation-data-type=VoidPtr
package /AUTOSAR_PbcfgM/ImplementationDataTypes
  impl type PbcfgM_StatusType: implementation-data-type=uint8, type-emitter=BSW
package /EB_PbcfgM_TxDxM1I2R0/Implementations
  bsw implementation BswImplementation_0: programming-language=C, sw-version=1.2.12, vendor-id=1, ar-release-version=4.0.3, behavior=InternalBehavior_0, vendor-specific-module-def=PbcfgM
    code-descriptors:
      code Files
        artifact-descriptors:
          short-label=Autosar::include::PbcfgM.h, category=SWHDR
          short-label=Autosar::include::PbcfgM_Api.h, category=SWHDR
          short-label=Autosar::include::PbcfgM_Int.h, category=SWHDR
          short-label=Autosar::include::PbcfgM_Trace_Internal.h, category=SWHDR
          short-label=Autosar::include::PbcfgM_Types.h, category=SWHDR
          short-label=Autosar::include::PbcfgM_Trace.h, category=SWHDR
          short-label=Autosar::include::PbcfgM_Version.h, category=SWHDR
          short-label=Autosar::src::PbcfgM.c, category=SWSRC
          short-label=make::PbcfgM_defs.mak, category=SWMAKE
          short-label=make::PbcfgM_rules.mak, category=SWMAKE
    resource consumption ResourceConsumption
      6 x memory section:
        CODE: sw-addrmethod=CODE
        VAR_FAST_INIT_UNSPECIFIED: alignment=UNSPECIFIED, sw-addrmethod=VAR_FAST
        VAR_FAST_INIT_8: alignment=8, sw-addrmethod=VAR_FAST
        CONST_32: alignment=32, sw-addrmethod=CONST
        CONST_UNSPECIFIED: alignment=UNSPECIFIED, sw-addrmethod=CONST
        CONFIG_DATA_UNSPECIFIED: alignment=UNSPECIFIED, sw-addrmethod=CONFIG_DATA
