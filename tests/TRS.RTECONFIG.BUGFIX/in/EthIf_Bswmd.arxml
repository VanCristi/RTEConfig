AUTOSAR XML (schema 4-0-3)
package /AUTOSAR_EthIf/BswModuleDescriptions
  bsw module description EthIf: module-id=65, provided-entrys=[EthIf_MainFunctionRx, EthIf_MainFunctionTx]
    bsw internal behavior InternalBehavior_0
      bsw schedulable entity EthIf_MainFunctionRx: implemented-entry=EthIf_MainFunctionRx
      bsw schedulable entity EthIf_MainFunctionTx: implemented-entry=EthIf_MainFunctionTx
      bsw timing event TimingEvent_MainFunctionRx: starts-on-event=EthIf_MainFunctionRx, period=0.01
      bsw timing event TimingEvent_MainFunctionTx: starts-on-event=EthIf_MainFunctionTx, period=0.01
package /AUTOSAR_EthIf/BswModuleEntrys
  bsw module entry EthIf_MainFunctionRx: service-id=32, is-reentrant=false, is-synchronous=true, call-type=SCHEDULED, execution-context=TASK, sw-service-impl-policy=STANDARD
  bsw module entry EthIf_MainFunctionTx: service-id=33, is-reentrant=false, is-synchronous=true, call-type=SCHEDULED, execution-context=TASK, sw-service-impl-policy=STANDARD
package /EB_EthIf_TxDxM1I7R0/Implementations
  bsw implementation BswImplementation_0: programming-language=C, sw-version=1.7.1, vendor-id=1, ar-release-version=4.0.3, behavior=InternalBehavior_0, vendor-specific-module-def=EthIf
    code-descriptors:
      code Files
        artifact-descriptors:
          short-label=Autosar::include::EthIf.h, category=SWHDR
          short-label=Autosar::include::EthIf_Cbk.h, category=SWHDR
          short-label=Autosar::include::EthIf_Int.h, category=SWHDR
          short-label=Autosar::include::EthIf_Trace.h, category=SWHDR
          short-label=Autosar::include::EthIf_Types.h, category=SWHDR
          short-label=Autosar::include::EthIf_Version.h, category=SWHDR
          short-label=Autosar::src::EthIf.c, category=SWSRC
          short-label=make::EthIf_defs.mak, category=SWMAKE
          short-label=make::EthIf_rules.mak, category=SWMAKE
    resource consumption ResourceConsumption
      8 x memory section:
        CODE: sw-addrmethod=CODE
        CONFIG_DATA_UNSPECIFIED: alignment=UNSPECIFIED, sw-addrmethod=CONFIG_DATA
        CONFIG_DATA_8: alignment=8, sw-addrmethod=CONFIG_DATA
        CONFIG_DATA_16: alignment=16, sw-addrmethod=CONFIG_DATA
        VAR_INIT_8: alignment=8, sw-addrmethod=VAR
        VAR_INIT_UNSPECIFIED: alignment=UNSPECIFIED, sw-addrmethod=VAR
        VAR_NO_INIT_8: alignment=16, sw-addrmethod=VAR_NOINIT
        VAR_NO_INIT_UNSPECIFIED: alignment=UNSPECIFIED, sw-addrmethod=VAR_NOINIT
