AUTOSAR XML (schema 4-2-1)
package /AUTOSAR_Dcm/PortInterfaces
  client server interface DataServices_DcmDspData_DID_OPTION_FMH: is-service=true
    operation ReadData
      arg Data: type=tBYTE, direction=OUT
    operation WriteData
      arg Data: type=tBYTE, direction=IN
      arg ErrorCode: type=tBYTE, direction=OUT
