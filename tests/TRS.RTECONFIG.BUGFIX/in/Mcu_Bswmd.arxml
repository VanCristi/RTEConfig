AUTOSAR XML (schema 4-0-3)
package /AUTOSAR_Mcu/BswModuleDescriptions
  bsw module description Mcu: module-id=101, provided-entrys=Mcu_Init
    bsw internal behavior InternalBehavior_0
      bsw called entity Mcu_Init: implemented-entry=Mcu_Init
package /AUTOSAR_Mcu/BswModuleEntrys
  bsw module entry Mcu_Init: service-id=101, is-reentrant=false, is-synchronous=true, call-type=REGULAR, execution-context=UNSPECIFIED, sw-service-impl-policy=STANDARD
package /Mcu_TS_T16D26M4I0R0/Implementations
  bsw implementation BswImplementation_0: programming-language=C, sw-version=4.0.0, vendor-id=17, ar-release-version=4.2.2, behavior=InternalBehavior_0, vendor-specific-module-def=Mcu
    code-descriptors:
      code Files: artifact-descriptors=[{short-label=make::Mcu_defs.mak, category=SWMAKE}, {short-label=make::Mcu_rules.mak, category=SWMAKE}]
    resource consumption ResourceConsumption
      4 x memory section:
        MCU_CODE: sw-addrmethod=CODE, symbol=CODE
        MCU_CODE_QM_LOCAL: sw-addrmethod=CODE, symbol=CODE_QM_LOCAL
        MCU_CONFIG_DATA_QM_UNSPECIFIED: alignment=UNSPECIFIED, sw-addrmethod=CONFIG_DATA, symbol=CONFIG_DATA_QM_UNSPECIFIED
        MCU_VAR_CLEARED_QM_LOCAL_32: alignment=32, sw-addrmethod=VAR, symbol=VAR_CLEARED_QM_LOCAL_32
