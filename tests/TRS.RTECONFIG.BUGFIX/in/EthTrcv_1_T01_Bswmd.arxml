AUTOSAR XML (schema 4-0-3)
package /AUTOSAR_EthTrcv_1_T01/BswModuleDescriptions
  bsw module description EthTrcv_1_T01: module-id=73, provided-entrys=EthTrcv_1_T01_Init
    bsw internal behavior InternalBehavior_0
      bsw called entity EthTrcv_1_T01_Init: implemented-entry=EthTrcv_1_T01_Init
package /AUTOSAR_EthTrcv_1_T01/BswModuleEntrys
  bsw module entry EthTrcv_1_T01_Init: service-id=1, is-reentrant=false, is-synchronous=true, call-type=REGULAR, execution-context=TASK, sw-service-impl-policy=STANDARD
package /EB_EthTrcv_1_T01_TxDxM1I2R0/Implementations
  bsw implementation BswImplementation_0: programming-language=C, sw-version=1.2.5, vendor-id=1, ar-release-version=4.0.3, behavior=InternalBehavior_0, vendor-specific-module-def=EthTrcv
    code-descriptors:
      code Files
        artifact-descriptors:
          short-label=Autosar_T01::include::EthTrcv.h, category=SWHDR
          short-label=Autosar_T01::include::EthTrcv_1_T01.h, category=SWHDR
          short-label=Autosar_T01::include::EthTrcv_1_T01_Derivate.h, category=SWHDR
          short-label=Autosar_T01::include::EthTrcv_1_T01_Priv_BCM89610.h, category=SWHDR
          short-label=Autosar_T01::include::EthTrcv_1_T01_Priv_BCM89810.h, category=SWHDR
          short-label=Autosar_T01::include::EthTrcv_1_T01_Priv_DP83848C.h, category=SWHDR
          short-label=Autosar_T01::include::EthTrcv_1_T01_Priv_PHY11G.h, category=SWHDR
          short-label=Autosar_T01::include::EthTrcv_1_T01_Priv_TJA110X.h, category=SWHDR
          short-label=Autosar_T01::include::EthTrcv_1_T01_Types.h, category=SWHDR
          short-label=Autosar_T01::include::EthTrcv_1_T01_Trace.h, category=SWHDR
          short-label=Autosar_T01::include::EthTrcv_1_T01_Version.h, category=SWHDR
          short-label=Autosar_T01::src::EthTrcv_1_T01_Priv_BCM89610.c, category=SWSRC
          short-label=Autosar_T01::src::EthTrcv_1_T01_Priv_BCM89810.c, category=SWSRC
          short-label=Autosar_T01::src::EthTrcv_1_T01_Priv_DP83848C.c, category=SWSRC
          short-label=Autosar_T01::src::EthTrcv_1_T01_Priv_PHY11G.c, category=SWSRC
          short-label=Autosar_T01::src::EthTrcv_1_T01_Priv_TJA110X.c, category=SWSRC
          short-label=Autosar_T01::src::EthTrcv_1_T01.c, category=SWSRC
          short-label=make::EthTrcv_1_T01_defs.mak, category=SWMAKE
          short-label=make::EthTrcv_1_T01_rules.mak, category=SWMAKE
    resource consumption ResourceConsumption
      4 x memory section:
        CONFIG_DATA_UNSPECIFIED: alignment=UNSPECIFIED, sw-addrmethod=CONFIG_DATA
        VAR_NO_INIT_UNSPECIFIED: alignment=UNSPECIFIED, sw-addrmethod=VAR_NOINIT
        VAR_INIT_UNSPECIFIED: alignment=UNSPECIFIED, sw-addrmethod=VAR
        CODE: sw-addrmethod=CODE
