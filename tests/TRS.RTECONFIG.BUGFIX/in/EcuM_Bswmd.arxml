AUTOSAR XML (schema 4-2-1)
package /AUTOSAR_EcuM/BswModuleDescriptions
  bsw module description EcuM: module-id=10, provided-entrys=[EcuM_MainFunction, EcuM_UpdateSleepMode, EcuM_SelectShutdownTarget, EcuM_GoDown, EcuM_GoHalt, EcuM_GoPoll]
    provided-datas:
      data EcuM_MasterCoreReadyPort: type=boolean
      data EcuM_SlaveCoreReadyPort: type=uint8
      data EcuM_SetSleepMode: type=uint8
    required-datas:
      data EcuM_MasterCoreSyncPort: type=boolean
      data EcuM_SlaveCoreSyncPort: type=uint8
      data EcuM_GetSleepMode: type=uint8
    bsw internal behavior InternalBehavior_0: bsw-queued-data-reception-policy{enable-take-address=true, received-data=EcuM_SlaveCoreSyncPort, queue-length=1}
      exclusive area SCHM_ECUM_EXCLUSIVE_AREA_0
      bsw called entity BswCalledEntity_EcuM_GoHalt: implemented-entry=EcuM_GoHalt
        data-receive-points:
          bsw variable access BswVariableAccess_EcuM_SlaveCoreSyncPort: accessed-variable=EcuM_SlaveCoreSyncPort
        data-send-points:
          bsw variable access BswVariableAccess_EcuM_MasterCoreReadyPort: accessed-variable=EcuM_MasterCoreReadyPort
      bsw called entity BswCalledEntity_EcuM_GoDown: implemented-entry=EcuM_GoDown
        data-receive-points:
          bsw variable access BswVariableAccess_EcuM_SlaveCoreSyncPort: accessed-variable=EcuM_SlaveCoreSyncPort
      bsw called entity BswCalledEntity_EcuM_SelectShutdownTarget: implemented-entry=EcuM_SelectShutdownTarget
        data-send-points:
          bsw variable access BswVariableAccess_EcuM_SetSleepMode: accessed-variable=EcuM_SetSleepMode
      bsw schedulable entity EcuM_MainFunction: can-enter-exclusive-area=SCHM_ECUM_EXCLUSIVE_AREA_0, implemented-entry=EcuM_MainFunction
      bsw timing event TimingEvent_MainFunction: starts-on-event=InternalBehavior_0/EcuM_MainFunction, period=0.02
    bsw internal behavior InternalBehavior_1
      exclusive area SCHM_ECUM_EXCLUSIVE_AREA_1
      bsw called entity BswCalledEntity_EcuM_GoHalt: implemented-entry=EcuM_GoHalt
        data-receive-points:
          bsw variable access BswVariableAccess_EcuM_MasterCoreSyncPort: accessed-variable=EcuM_MasterCoreSyncPort
        data-send-points:
          bsw variable access BswVariableAccess_EcuM_SlaveCoreReadyPort: accessed-variable=EcuM_SlaveCoreReadyPort
      bsw called entity BswCalledEntity_EcuM_GoPoll: implemented-entry=EcuM_GoPoll
        data-receive-points:
          bsw variable access BswVariableAccess_EcuM_MasterCoreSyncPort: accessed-variable=EcuM_MasterCoreSyncPort
      bsw called entity BswCalledEntity_EcuM_GoDown: implemented-entry=EcuM_GoDown
        data-send-points:
          bsw variable access BswVariableAccess_EcuM_SlaveCoreReadyPort: accessed-variable=EcuM_SlaveCoreReadyPort
      bsw schedulable entity EcuM_MainFunction: can-enter-exclusive-area=SCHM_ECUM_EXCLUSIVE_AREA_1, implemented-entry=EcuM_MainFunction
      bsw schedulable entity EcuM_UpdateSleepMode: can-enter-exclusive-area=SCHM_ECUM_EXCLUSIVE_AREA_1, implemented-entry=EcuM_UpdateSleepMode
        data-receive-points:
          bsw variable access BswVariableAccess_EcuM_GetSleepMode: accessed-variable=EcuM_GetSleepMode
      bsw timing event TimingEvent_MainFunction: starts-on-event=InternalBehavior_1/EcuM_MainFunction, period=0.02
      bsw data received event DataReceivedEvent_UpdateSleepMode: starts-on-event=EcuM_UpdateSleepMode, data=EcuM_GetSleepMode
package /AUTOSAR_EcuM/BswModuleEntrys
  6 x bsw module entry, all with is-synchronous=true, sw-service-impl-policy=STANDARD:
    EcuM_MainFunction: service-id=24, is-reentrant=false, call-type=SCHEDULED, execution-context=TASK
    EcuM_UpdateSleepMode: service-id=0, is-reentrant=true, call-type=SCHEDULED, execution-context=TASK
    EcuM_SelectShutdownTarget: service-id=6, is-reentrant=true, call-type=REGULAR, execution-context=UNSPECIFIED
    EcuM_GoDown: service-id=31, is-reentrant=true, call-type=REGULAR, execution-context=UNSPECIFIED
    EcuM_GoHalt: service-id=32, is-reentrant=true, call-type=REGULAR, execution-context=UNSPECIFIED
    EcuM_GoPoll: service-id=33, is-reentrant=true, call-type=REGULAR, execution-context=UNSPECIFIED
package /EB_EcuM_TxDxM5I13R0/Implementations
  bsw implementation BswImplementation_0: programming-language=C, sw-version=5.13.0, vendor-id=1, ar-release-version=4.0.3, behavior=InternalBehavior_0, vendor-specific-module-def=EcuM
    code-descriptors:
      code Files
        artifact-descriptors:
          short-label=Autosar::include::EcuM.h, category=SWHDR
          short-label=Autosar::include::EcuM_BSW.h, category=SWHDR
          short-label=Autosar::include::EcuM_BSW_Types.h, category=SWHDR
          short-label=Autosar::include::EcuM_BootTarget.h, category=SWHDR
          short-label=Autosar::include::EcuM_Cbk.h, category=SWHDR
          short-label=Autosar::include::EcuM_Trace_Internal.h, category=SWHDR
          short-label=Autosar::include::EcuM_Types.h, category=SWHDR
          short-label=Autosar::include::EcuM_Int.h, category=SWHDR
          short-label=Autosar::include::EcuM_Trace.h, category=SWHDR
          short-label=Autosar::include::EcuM_Version.h, category=SWHDR
          short-label=Autosar::src::EcuM_ASR32_Rte.c, category=SWSRC
          short-label=Autosar::src::EcuM_ASR40_Rte.c, category=SWSRC
          short-label=Autosar::src::EcuM_BootTarget.c, category=SWSRC
          short-label=Autosar::src::EcuM_Rte.c, category=SWSRC
          short-label=Autosar::src::EcuM.c, category=SWSRC
          short-label=make::EcuM_defs.mak, category=SWMAKE
          short-label=make::EcuM_rules.mak, category=SWMAKE
    resource consumption ResourceConsumption
      12 x memory section:
        INTERNAL_VAR_POWER_ON_INIT_UNSPECIFIED: alignment=UNSPECIFIED, sw-addrmethod=VAR_POWER_ON_INIT
        VAR_POWER_ON_INIT_8: alignment=8, sw-addrmethod=VAR_POWER_ON_INIT
        VAR_NO_INIT_8: alignment=8, sw-addrmethod=VAR_NOINIT
        VAR_NO_INIT_16: alignment=16, sw-addrmethod=VAR_NOINIT
        CONST_8: alignment=8, sw-addrmethod=CONST
        VAR_INIT_8: alignment=8, sw-addrmethod=VAR
        CONST_16: alignment=16, sw-addrmethod=CONST
        VAR_NO_INIT_UNSPECIFIED: alignment=UNSPECIFIED, sw-addrmethod=VAR_NOINIT
        VAR_INIT_UNSPECIFIED: alignment=UNSPECIFIED, sw-addrmethod=VAR
        VAR_CLEARED_UNSPECIFIED: sw-addrmethod=VAR_CLEARED
        CONST_UNSPECIFIED: alignment=UNSPECIFIED, sw-addrmethod=CONST
        CODE: sw-addrmethod=CODE
  bsw implementation BswImplementation_1: programming-language=C, sw-version=5.13.0, vendor-id=1, ar-release-version=4.0.3, behavior=InternalBehavior_1, vendor-api-infix=Core_1, vendor-specific-module-def=EcuM
    code-descriptors:
      code Files
        artifact-descriptors:
          short-label=Autosar::include::EcuM.h, category=SWHDR
          short-label=Autosar::include::EcuM_BSW.h, category=SWHDR
          short-label=Autosar::include::EcuM_BSW_Types.h, category=SWHDR
          short-label=Autosar::include::EcuM_BootTarget.h, category=SWHDR
          short-label=Autosar::include::EcuM_Cbk.h, category=SWHDR
          short-label=Autosar::include::EcuM_Trace_Internal.h, category=SWHDR
          short-label=Autosar::include::EcuM_Types.h, category=SWHDR
          short-label=Autosar::include::EcuM_Int.h, category=SWHDR
          short-label=Autosar::include::EcuM_Trace.h, category=SWHDR
          short-label=Autosar::include::EcuM_Version.h, category=SWHDR
          short-label=Autosar::src::EcuM_ASR32_Rte.c, category=SWSRC
          short-label=Autosar::src::EcuM_ASR40_Rte.c, category=SWSRC
          short-label=Autosar::src::EcuM_BootTarget.c, category=SWSRC
          short-label=Autosar::src::EcuM_Rte.c, category=SWSRC
          short-label=Autosar::src::EcuM.c, category=SWSRC
          short-label=make::EcuM_defs.mak, category=SWMAKE
          short-label=make::EcuM_rules.mak, category=SWMAKE
    resource consumption ResourceConsumption
      12 x memory section:
        INTERNAL_VAR_POWER_ON_INIT_UNSPECIFIED: alignment=UNSPECIFIED, sw-addrmethod=VAR_POWER_ON_INIT
        VAR_POWER_ON_INIT_8: alignment=8, sw-addrmethod=VAR_POWER_ON_INIT
        VAR_NO_INIT_8: alignment=8, sw-addrmethod=VAR_NOINIT
        VAR_NO_INIT_16: alignment=16, sw-addrmethod=VAR_NOINIT
        CONST_8: alignment=8, sw-addrmethod=CONST
        VAR_INIT_8: alignment=8, sw-addrmethod=VAR
        CONST_16: alignment=16, sw-addrmethod=CONST
        VAR_NO_INIT_UNSPECIFIED: alignment=UNSPECIFIED, sw-addrmethod=VAR_NOINIT
        VAR_INIT_UNSPECIFIED: alignment=UNSPECIFIED, sw-addrmethod=VAR
        VAR_CLEARED_UNSPECIFIED: sw-addrmethod=VAR_CLEARED
        CONST_UNSPECIFIED: alignment=UNSPECIFIED, sw-addrmethod=CONST
        CODE: sw-addrmethod=CODE
