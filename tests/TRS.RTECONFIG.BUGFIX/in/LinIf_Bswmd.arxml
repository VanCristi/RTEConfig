AUTOSAR XML (schema 4-0-3)
package /AUTOSAR_LinIf/BswModuleDescriptions
  bsw module description LinIf: module-id=62, provided-entrys=LinIf_MainFunction
    bsw internal behavior InternalBehavior_0
      exclusive area SCHM_LINIF_EXCLUSIVE_AREA_0
      bsw schedulable entity LinIf_MainFunction: can-enter-exclusive-area=SCHM_LINIF_EXCLUSIVE_AREA_0, implemented-entry=LinIf_MainFunction
      bsw timing event TimingEvent_MainFunction: starts-on-event=LinIf_MainFunction, period=0.005
package /AUTOSAR_LinIf/BswModuleEntrys
  bsw module entry LinIf_MainFunction: service-id=128, is-reentrant=false, is-synchronous=true, call-type=SCHEDULED, execution-context=TASK, sw-service-impl-policy=STANDARD
package /EB_LinIf_TxDxM5I6R0/Implementations
  bsw implementation BswImplementation_0: programming-language=C, sw-version=5.6.0, vendor-id=1, ar-release-version=4.0.3, behavior=InternalBehavior_0, vendor-specific-module-def=LinIf
    code-descriptors:
      code Files
        artifact-descriptors:
          short-label=Autosar::include::LinIf.h, category=SWHDR
          short-label=Autosar::include::LinIf_Cbk.h, category=SWHDR
          short-label=Autosar::include::LinIf_Trace_Internal.h, category=SWHDR
          short-label=Autosar::include::LinIf_Types.h, category=SWHDR
          short-label=Autosar::include::LinTp.h, category=SWHDR
          short-label=Autosar::include::LinTp_Int.h, category=SWHDR
          short-label=Autosar::include::LinTp_Types.h, category=SWHDR
          short-label=Autosar::include::LinIf_Int.h, category=SWHDR
          short-label=Autosar::include::LinIf_Trace.h, category=SWHDR
          short-label=Autosar::include::LinIf_Version.h, category=SWHDR
          short-label=Autosar::src::LinIf_CheckWakeup.c, category=SWSRC
          short-label=Autosar::src::LinIf_GetVersionInfo.c, category=SWSRC
          short-label=Autosar::src::LinIf_GotoSleep.c, category=SWSRC
          short-label=Autosar::src::LinIf_Init.c, category=SWSRC
          short-label=Autosar::src::LinIf_MainFunction.c, category=SWSRC
          short-label=Autosar::src::LinIf_Merged.c, category=SWSRC
          short-label=Autosar::src::LinIf_ScheduleRequest.c, category=SWSRC
          short-label=Autosar::src::LinIf_Transmit.c, category=SWSRC
          short-label=Autosar::src::LinIf_Trcv.c, category=SWSRC
          short-label=Autosar::src::LinIf_Wakeup.c, category=SWSRC
          short-label=Autosar::src::LinTp_CancelReceive.c, category=SWSRC
          short-label=Autosar::src::LinTp_CancelTransmit.c, category=SWSRC
          short-label=Autosar::src::LinTp_ChangeParameter.c, category=SWSRC
          short-label=Autosar::src::LinTp_GetVersionInfo.c, category=SWSRC
          short-label=Autosar::src::LinTp_Init.c, category=SWSRC
          short-label=Autosar::src::LinTp_MainFunction.c, category=SWSRC
          short-label=Autosar::src::LinTp_Transmit.c, category=SWSRC
          short-label=Autosar::src::LinIf.c, category=SWSRC
          short-label=make::LinIf_defs.mak, category=SWMAKE
          short-label=make::LinIf_rules.mak, category=SWMAKE
    resource consumption ResourceConsumption
      7 x memory section:
        CODE: sw-addrmethod=CODE
        CONST_32: alignment=32, sw-addrmethod=CONST
        VAR_INIT_8: alignment=8, sw-addrmethod=VAR
        VAR_NO_INIT_UNSPECIFIED: alignment=UNSPECIFIED, sw-addrmethod=VAR
        CONFIG_DATA_UNSPECIFIED: alignment=UNSPECIFIED, sw-addrmethod=CONFIG_DATA
        VAR_INIT_UNSPECIFIED: alignment=UNSPECIFIED, sw-addrmethod=VAR
        CONST_UNSPECIFIED: alignment=UNSPECIFIED, sw-addrmethod=CONST
