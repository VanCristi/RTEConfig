AUTOSAR XML (schema 4-0-3)
package /AUTOSAR_LinSM/BswModuleDescriptions
  bsw module description LinSM: module-id=141, provided-entrys=LinSM_MainFunction
    bsw internal behavior InternalBehavior_0
      exclusive area SCHM_LINSM_EXCLUSIVE_AREA_0
      bsw schedulable entity LinSM_MainFunction: can-enter-exclusive-area=SCHM_LINSM_EXCLUSIVE_AREA_0, implemented-entry=LinSM_MainFunction
      bsw timing event TimingEvent_MainFunction: starts-on-event=LinSM_MainFunction, period=0.02
package /AUTOSAR_LinSM/BswModuleEntrys
  bsw module entry LinSM_MainFunction: service-id=0x30, is-reentrant=false, is-synchronous=true, call-type=SCHEDULED, execution-context=TASK, sw-service-impl-policy=STANDARD
package /EB_LinSM_TxDxM3I2R0/Implementations
  bsw implementation BswImplementation_0: programming-language=C, sw-version=3.2.10, vendor-id=1, ar-release-version=4.0.3, behavior=InternalBehavior_0, vendor-specific-module-def=LinSM
    code-descriptors:
      code Files
        artifact-descriptors:
          short-label=Autosar::include::LinSM.h, category=SWHDR
          short-label=Autosar::include::LinSM_Api.h, category=SWHDR
          short-label=Autosar::include::LinSM_Cbk.h, category=SWHDR
          short-label=Autosar::include::LinSM_Trace_Internal.h, category=SWHDR
          short-label=Autosar::include::LinSM_Internal.h, category=SWHDR
          short-label=Autosar::include::LinSM_Trace.h, category=SWHDR
          short-label=Autosar::include::LinSM_Version.h, category=SWHDR
          short-label=Autosar::src::LinSM_GetCurrentComMode.c, category=SWSRC
          short-label=Autosar::src::LinSM_GetVersionInfo.c, category=SWSRC
          short-label=Autosar::src::LinSM_GotoSleepConfirmation.c, category=SWSRC
          short-label=Autosar::src::LinSM_Init.c, category=SWSRC
          short-label=Autosar::src::LinSM_MainFunction.c, category=SWSRC
          short-label=Autosar::src::LinSM_Merged.c, category=SWSRC
          short-label=Autosar::src::LinSM_RequestComMode.c, category=SWSRC
          short-label=Autosar::src::LinSM_ScheduleRequest.c, category=SWSRC
          short-label=Autosar::src::LinSM_ScheduleRequestConfirmation.c, category=SWSRC
          short-label=Autosar::src::LinSM_WakeupConfirmation.c, category=SWSRC
          short-label=Autosar::src::LinSM.c, category=SWSRC
          short-label=make::LinSM_defs.mak, category=SWMAKE
          short-label=make::LinSM_rules.mak, category=SWMAKE
    resource consumption ResourceConsumption
      4 x memory section:
        CODE: sw-addrmethod=CODE
        VAR_NO_INIT_UNSPECIFIED: alignment=UNSPECIFIED, sw-addrmethod=VAR_NOINIT
        VAR_INIT_8: alignment=8, sw-addrmethod=VAR
        CONFIG_DATA_UNSPECIFIED: alignment=UNSPECIFIED, sw-addrmethod=CONFIG_DATA
