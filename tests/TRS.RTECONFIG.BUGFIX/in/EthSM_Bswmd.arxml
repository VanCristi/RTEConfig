AUTOSAR XML (schema 4-0-3)
package /AUTOSAR_EthSM/BswModuleDescriptions
  bsw module description EthSM: module-id=143, provided-entrys=EthSM_MainFunction
    bsw internal behavior InternalBehavior_0
      exclusive area SCHM_ETHSM_EXCLUSIVE_AREA_0
      bsw schedulable entity EthSM_MainFunction: can-enter-exclusive-area=SCHM_ETHSM_EXCLUSIVE_AREA_0, implemented-entry=EthSM_MainFunction
      bsw timing event TimingEvent_MainFunction: starts-on-event=EthSM_MainFunction, period=0.01
package /AUTOSAR_EthSM/BswModuleEntrys
  bsw module entry EthSM_MainFunction: service-id=0, is-reentrant=false, is-synchronous=true, call-type=SCHEDULED, execution-context=TASK, sw-service-impl-policy=STANDARD
package /EB_EthSM_TxDxM1I5R0/Implementations
  bsw implementation BswImplementation_0: programming-language=C, sw-version=1.5.10, vendor-id=1, ar-release-version=4.0.3, behavior=InternalBehavior_0, vendor-specific-module-def=EthSM
    code-descriptors:
      code Files
        artifact-descriptors:
          short-label=Autosar::include::EthSM.h, category=SWHDR
          short-label=Autosar::include::EthSM_Cbk.h, category=SWHDR
          short-label=Autosar::include::EthSM_Trace.h, category=SWHDR
          short-label=Autosar::include::EthSM_Types.h, category=SWHDR
          short-label=Autosar::include::EthSM_Version.h, category=SWHDR
          short-label=Autosar::src::EthSM.c, category=SWSRC
          short-label=make::EthSM_defs.mak, category=SWMAKE
          short-label=make::EthSM_rules.mak, category=SWMAKE
    resource consumption ResourceConsumption
      8 x memory section:
        CONFIG_DATA_UNSPECIFIED: alignment=UNSPECIFIED, sw-addrmethod=CONFIG_DATA
        VAR_INIT_8: alignment=8, sw-addrmethod=VAR
        VAR_INIT_16: alignment=16, sw-addrmethod=VAR
        VAR_INIT_UNSPECIFIED: alignment=UNSPECIFIED, sw-addrmethod=VAR
        VAR_NO_INIT_16: alignment=16, sw-addrmethod=VAR_NOINIT
        VAR_NO_INIT_UNSPECIFIED: alignment=UNSPECIFIED, sw-addrmethod=VAR_NOINIT
        CONST_UNSPECIFIED: alignment=UNSPECIFIED, sw-addrmethod=CONST
        CODE: sw-addrmethod=CODE
