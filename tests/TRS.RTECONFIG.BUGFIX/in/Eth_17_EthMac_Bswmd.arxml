AUTOSAR XML (schema 4-0-3)
package /AUTOSAR_Eth/BswModuleDescriptions
  bsw module description Eth_17_EthMac: module-id=88, provided-entrys=[Eth_17_EthMac_Init, Eth_17_EthMac_MainFunction]
    bsw internal behavior InternalBehavior_0
      4 x exclusive area:
        ProvideTxBuffer
        SetControllerMode
        Transmit
        UpdateGlobalTime
      bsw called entity Eth_17_EthMac_Init: can-enter-exclusive-area=[ProvideTxBuffer, SetControllerMode, Transmit, UpdateGlobalTime], implemented-entry=Eth_17_EthMac_Init, scheduler-name-prefix=Prefix_Eth_17_EthMac
      bsw schedulable entity Eth_17_EthMac_MainFunction: implemented-entry=Eth_17_EthMac_MainFunction
      bsw timing event TimingEvent_MainFunction: starts-on-event=Eth_17_EthMac_MainFunction, period=0.001
      bsw scheduler name prefix Prefix_Eth_17_EthMac: symbol=Eth_17_EthMac
package /AUTOSAR_Eth/BswModuleEntrys
  bsw module entry Eth_17_EthMac_Init: service-id=0, is-reentrant=false, is-synchronous=true, call-type=REGULAR, execution-context=UNSPECIFIED, sw-service-impl-policy=STANDARD
  bsw module entry Eth_17_EthMac_MainFunction: service-id=10, is-reentrant=false, is-synchronous=true, call-type=SCHEDULED, execution-context=TASK, sw-service-impl-policy=STANDARD
package /Eth_TS_T16D26M2I0R0/Implementations
  bsw implementation BswImplementation_0: programming-language=C, sw-version=2.0.0, vendor-id=17, ar-release-version=4.2.2, behavior=InternalBehavior_0, vendor-specific-module-def=Eth
    code-descriptors:
      code Files: artifact-descriptors=[{short-label=make::Eth_defs.mak, category=SWMAKE}, {short-label=make::Eth_rules.mak, category=SWMAKE}]
    resource consumption ResourceConsumption
      6 x memory section, all with prefix=ETH_17_ETHMAC:
        ETH_17_ETHMAC_CODE: sw-addrmethod=CODE, symbol=CODE
        ETH_17_ETHMAC_CODE_QM_GLOBAL: sw-addrmethod=CODE, symbol=CODE_QM_GLOBAL
        ETH_17_ETHMAC_CONFIG_DATA_QM_UNSPECIFIED: alignment=UNSPECIFIED, sw-addrmethod=CONFIG_DATA, symbol=CONFIG_DATA_QM_UNSPECIFIED
        ETH_17_ETHMAC_VAR_CLEARED_QM_GLOBAL_16: alignment=16, sw-addrmethod=VAR, symbol=VAR_CLEARED_QM_GLOBAL_16
        ETH_17_ETHMAC_VAR_CLEARED_QM_GLOBAL_32: alignment=32, sw-addrmethod=VAR, symbol=VAR_CLEARED_QM_GLOBAL_32
        ETH_17_ETHMAC_VAR_CLEARED_QM_GLOBAL_8: alignment=8, sw-addrmethod=VAR, symbol=VAR_CLEARED_QM_GLOBAL_8
      section name prefix ETH_17_ETHMAC
