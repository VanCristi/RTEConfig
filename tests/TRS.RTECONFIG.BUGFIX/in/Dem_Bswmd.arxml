AUTOSAR XML (schema 4-0-3)
package /AUTOSAR_Dem/BswModuleDescriptions
  bsw module description Dem: module-id=54, provided-entrys=Dem_MainFunction
    bsw internal behavior InternalBehavior_0
      exclusive area SCHM_DEM_EXCLUSIVE_AREA_0
      bsw schedulable entity Dem_MainFunction: can-enter-exclusive-area=SCHM_DEM_EXCLUSIVE_AREA_0, implemented-entry=Dem_MainFunction
      bsw timing event TimingEvent_MainFunction: starts-on-event=Dem_MainFunction, period=0.02
package /AUTOSAR_Dem/BswModuleEntrys
  bsw module entry Dem_MainFunction: service-id=85, is-reentrant=false, is-synchronous=true, call-type=SCHEDULED, execution-context=TASK, sw-service-impl-policy=STANDARD
package /EB_Dem_TxDxM5I17R0/Implementations
  bsw implementation BswImplementation_0: programming-language=C, sw-version=5.17.22, vendor-id=1, ar-release-version=4.0.3, behavior=InternalBehavior_0
    code-descriptors:
      code Files
        artifact-descriptors:
          short-label=Autosar::include::Dem.h, category=SWHDR
          short-label=Autosar::include::Dem_BSW_Types.h, category=SWHDR
          short-label=Autosar::include::Dem_Int_Stc.h, category=SWHDR
          short-label=Autosar::include::Dem_NvMCbk.h, category=SWHDR
          short-label=Autosar::include::Dem_Stc.h, category=SWHDR
          short-label=Autosar::include::Dem_Types.h, category=SWHDR
          short-label=Autosar::include::Dem_Int.h, category=SWHDR
          short-label=Autosar::include::Dem_Trace.h, category=SWHDR
          short-label=Autosar::include::Dem_Version.h, category=SWHDR
          short-label=Autosar::src::Dem_Core.c, category=SWSRC
          short-label=Autosar::src::Dem_DcmIfAccess.c, category=SWSRC
          short-label=Autosar::src::Dem_DcmIfFFandED.c, category=SWSRC
          short-label=Autosar::src::Dem_DcmIfOBD.c, category=SWSRC
          short-label=Autosar::src::Dem_DcmIfStatusInfo.c, category=SWSRC
          short-label=Autosar::src::Dem.c, category=SWSRC
          short-label=make::Dem_defs.mak, category=SWMAKE
          short-label=make::Dem_rules.mak, category=SWMAKE
    resource consumption ResourceConsumption
      10 x memory section:
        VAR_NO_INIT_32: alignment=32, sw-addrmethod=VAR_NOINIT
        VAR_NO_INIT_16: alignment=16, sw-addrmethod=VAR_NOINIT
        VAR_NO_INIT_8: alignment=8, sw-addrmethod=VAR_NOINIT
        VAR_SAVED_ZONE_16: alignment=16, sw-addrmethod=VAR_NOINIT
        VAR_SAVED_ZONE_UNSPECIFIED: alignment=UNSPECIFIED, sw-addrmethod=VAR_NOINIT
        VAR_NO_INIT_UNSPECIFIED: alignment=UNSPECIFIED, sw-addrmethod=VAR_NOINIT
        VAR_INIT_UNSPECIFIED: alignment=UNSPECIFIED, sw-addrmethod=VAR
        CONST_UNSPECIFIED: alignment=UNSPECIFIED, sw-addrmethod=CONST
        CONST_8: alignment=8, sw-addrmethod=CONST
        CODE: sw-addrmethod=CODE
