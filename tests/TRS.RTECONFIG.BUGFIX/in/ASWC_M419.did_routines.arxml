AUTOSAR XML (schema 4-2-1)
package /AUTOSAR_Dcm/PortInterfaces
  client server interface DataServices_DcmDspData_DID_ActivAntiBrAR: is-service=true
    operation ReadData
      arg Data: type=tBYTE, direction=OUT
  client server interface DataServices_DcmDspData_DID_ActivAntiBrAV: is-service=true
    operation ReadData
      arg Data: type=tBYTE, direction=OUT
