AUTOSAR XML (schema 4-2-2)
package /RootP_NetworkDesc/CONFIG
  can tp config CanTpConfig: communication-cluster=DIAG, can-tp-ecu{cycle-time-main-function=0.005, ecu-instance=VSM}
    can tp address CanTpAddress_Dcm: tp-address=0
    can tp address CanTpAddress_Dcm_Dummy: tp-address=0
    can tp channel CanTpChannel_Dcm: channel-id=1, channel-mode=FULL-DUPLEX-MODE
    tp-connections:
      addressing-format=STANDARD, can-tp-channel=CanTpChannel_Dcm, data-pdu=NPdu_RxNPduDcm, flow-control-pdu=NPdu_TxNPduDcm, max-block-size=255, padding-activation=false, receiver=CanTpNode_Dcm, timeout-br=1.0, timeout-cr=1.0, tp-sdu=DcmIPdu_RxDcmIPduDcm, transmitter=CanTpNode_Dcm_Dummy
      addressing-format=STANDARD, can-tp-channel=CanTpChannel_Dcm, data-pdu=NPdu_TxNPduDcm, flow-control-pdu=NPdu_RxNPduDcm, max-block-size=255, padding-activation=false, receiver=CanTpNode_Dcm_Dummy, timeout-bs=1.0, timeout-cs=1.0, tp-sdu=DcmIPdu_TxDcmIPduDcm, transmitter=CanTpNode_Dcm
    can tp node CanTpNode_Dcm: connector=cc_DIAG_REP_BSI_DIAG, max-fc-wait=255, st-min=0.005, timeout-ar=1.0, timeout-as=1.0, tp-address=CanTpAddress_Dcm
    can tp node CanTpNode_Dcm_Dummy: max-fc-wait=255, st-min=0.005, timeout-ar=1.0, timeout-as=1.0, tp-address=CanTpAddress_Dcm_Dummy
