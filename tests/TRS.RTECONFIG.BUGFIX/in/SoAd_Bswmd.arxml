AUTOSAR XML (schema 4-0-3)
package /AUTOSAR_SoAd/BswModuleDescriptions
  bsw module description SoAd: module-id=56, provided-entrys=SoAd_MainFunction
    bsw internal behavior InternalBehavior_0
      exclusive area SCHM_SOAD_EXCLUSIVE_AREA_0
      bsw schedulable entity SoAd_MainFunction: can-enter-exclusive-area=SCHM_SOAD_EXCLUSIVE_AREA_0, implemented-entry=SoAd_MainFunction
      bsw timing event TimingEvent_MainFunction: starts-on-event=SoAd_MainFunction, period=0.1
package /AUTOSAR_SoAd/BswModuleEntrys
  bsw module entry SoAd_MainFunction: service-id=139, is-reentrant=false, is-synchronous=true, call-type=SCHEDULED, execution-context=TASK, sw-service-impl-policy=STANDARD
package /EB_SoAd_TxDxM1I7R0/Implementations
  bsw implementation BswImplementation_0: programming-language=C, sw-version=1.7.14, vendor-id=1, ar-release-version=4.0.3, behavior=InternalBehavior_0, vendor-specific-module-def=SoAd
    code-descriptors:
      code Files
        artifact-descriptors:
          short-label=Autosar::include::SoAd.h, category=SWHDR
          short-label=Autosar::include::SoAd_Cbk.h, category=SWHDR
          short-label=Autosar::include::SoAd_Trace_Internal.h, category=SWHDR
          short-label=Autosar::include::SoAd_Int.h, category=SWHDR
          short-label=Autosar::include::SoAd_Trace.h, category=SWHDR
          short-label=Autosar::include::SoAd_Version.h, category=SWHDR
          short-label=Autosar::src::SoAd_01_UdpSM.c, category=SWSRC
          short-label=Autosar::src::SoAd_01_UdpSM_User.c, category=SWSRC
          short-label=Autosar::src::SoAd_02_SocketCon.c, category=SWSRC
          short-label=Autosar::src::SoAd_03_Lib.c, category=SWSRC
          short-label=Autosar::src::SoAd_04_TcpSM.c, category=SWSRC
          short-label=Autosar::src::SoAd_04_TcpSM_User.c, category=SWSRC
          short-label=Autosar::src::SoAd_Merged.c, category=SWSRC
          short-label=Autosar::src::SoAd.c, category=SWSRC
          short-label=make::SoAd_defs.mak, category=SWMAKE
          short-label=make::SoAd_rules.mak, category=SWMAKE
    resource consumption ResourceConsumption
      8 x memory section:
        CODE: sw-addrmethod=CODE
        VAR_INIT_8: alignment=8, sw-addrmethod=VAR
        VAR_INIT_UNSPECIFIED: alignment=UNSPECIFIED, sw-addrmethod=VAR
        VAR_NO_INIT_UNSPECIFIED: alignment=UNSPECIFIED, sw-addrmethod=VAR_NOINIT
        VAR_NO_INIT_32: alignment=32, sw-addrmethod=VAR_NOINIT
        CONST_8: alignment=8, sw-addrmethod=CONST
        CONST_UNSPECIFIED: alignment=UNSPECIFIED, sw-addrmethod=CONST
        CONFIG_DATA_UNSPECIFIED: alignment=UNSPECIFIED, sw-addrmethod=CONFIG_DATA
