AUTOSAR XML (schema 4-0-3)
package /AUTOSAR_Port/BswModuleDescriptions
  bsw module description Port: module-id=124, provided-entrys=Port_Init
    bsw internal behavior InternalBehavior_0
      bsw called entity Port_Init: implemented-entry=Port_Init
package /AUTOSAR_Port/BswModuleEntrys
  bsw module entry Port_Init: service-id=124, is-reentrant=false, is-synchronous=true, call-type=REGULAR, execution-context=UNSPECIFIED, sw-service-impl-policy=STANDARD
package /Port_TS_T16D26M1I1R0/Implementations
  bsw implementation BswImplementation_0: programming-language=C, sw-version=1.1.0, vendor-id=17, ar-release-version=4.2.2, behavior=InternalBehavior_0, vendor-specific-module-def=Port
    code-descriptors:
      code Files
        artifact-descriptors:
          short-label=make::Port_defs.mak, category=SWMAKE
          short-label=make::Port_rules.mak, category=SWMAKE
    resource consumption ResourceConsumption
      5 x memory section:
        PORT_CODE_QM_GLOBAL: sw-addrmethod=CODE, symbol=CODE_QM_GLOBAL
        PORT_CONFIG_DATA_QM_UNSPECIFIED: alignment=UNSPECIFIED, sw-addrmethod=CONFIG_DATA, symbol=CONFIG_DATA_QM_UNSPECIFIED
        PORT_CONST_QM_16: alignment=16, sw-addrmethod=CONST, symbol=CONST_QM_16
        PORT_VAR_CLEARED_QM_32: alignment=32, sw-addrmethod=VAR, symbol=VAR_CLEARED_QM_32
        PORT_VAR_CLEARED_QM_8: alignment=8, sw-addrmethod=VAR, symbol=VAR_CLEARED_QM_8
